AUTOSAR XML (schema 4-0-3)
package /Continental_08/PowerSAR/System
  system SystemU_System: category=ECU_EXTRACT
    system mapping SystemMapping
    root-software-compositions:
      root sw composition prototype SystemU: software-composition=SystemU_Root
package /Continental_08/PowerSAR/System/EcucValueCollections
  ecuc value collection SystemU_EcuCValues: ecu-extract=SystemU_System, ecuc-values=[FiM, Dem, DemGenr]
