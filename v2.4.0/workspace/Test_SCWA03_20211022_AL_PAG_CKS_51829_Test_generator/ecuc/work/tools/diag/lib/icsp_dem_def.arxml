AUTOSAR XML (schema 4-0-3)
# The material contained in this specification is protected by copyright and
# other types of Intellectual Property Rights. The commercial exploitation of
# the material contained in this specification requires a license to such
# Intellectual Property Rights.
# This specification may be utilized or reproduced without any modification, in
# any form or by any means, for informational purposes only.
# For any other purpose, no part of the specification may be utilized or
# reproduced, in any form or by any means, without permission in writing from
# the publisher.
# licensed under the same rules as applicable to the AUTOSAR Standard.
package /AUTOSAR/EcucDefs
  module definition Dem [0..1]: variants post-build/pre-compile  # Configuration of the Dem (Diagnostic Event Manager) module.
    container DemConfigSet: multiple-configuration-container=true  # This container contains the configuration parameters and sub containers of the Dem module supporting multiple configuration sets. This container is a MultipleConfigurationContainer, i.e. this container and its sub-containers exist once per configuration set.
      container DemDTCClass [0..65535]  # This container contains the configuration (parameters) for DTCClass.
        integer DemDTCFunctionalUnit: 0..255, set at pre-compile  # DTCFuncitonalUnit is a 1-byte value which identifies the corresponding basic vehicle / system function which reports the DTC. This parameter is necessary for the report of severity informations.
        enumeration DemDTCSeverity [0..1]: {DEM_DTC_SEV_CHECK_AT_NEXT_HALT, DEM_DTC_SEV_IMMEDIATELY, DEM_DTC_SEV_MAINTENANCE_ONLY, DEM_DTC_SEV_NO_SEVERITY}, set at pre-compile  # DTC severity | This parameter depends on automotive manufacturer and is optional.
        boolean DemImmediateNvStorage: set at pre-compile  # Switch to enable immediate storage triggering of an according event memory entriy persistently to NVRAM. | true: immediate non-volatile storage triggering enabled false: immediate non-volatile storage triggering disabled
        integer DemObdDTC [0..1]: 1..65535, set at post-build in variant post-build / pre-compile in variant pre-compile  # Unique Diagnostic Trouble Code value for OBD
        integer DemUdsDTC [0..1]: 1..16777214, set at post-build in variant post-build / pre-compile in variant pre-compile  # Unique Diagnostic Trouble Code value for UDS | (Range: 0x000000 and 0xFFFFFF are reserved for DTC groups by ISO 14229-1)
        container DemCallbackInitMForF [0..*]  # The presence of this container indicates, that the Dem has access to an "InitMonitorForFunction" callback, which the Dem will call to initialize a monitor. | In case the container has a DemCallbackInitMForFFnc, this parameter defines the name of the function that the Dem will call. In case there is no DemCallbackInitMForFFnc, the Dem will have an R-Port requiring the interface CallbackInitMonitorForFunction, whose name is generated by using the unique callback-prefix followed by the event name.
          function name DemCallbackInitMForFFnc [0..1]: set at pre-compile  # Function name of prototype "InitMonitorForFunction".
      container DemEventParameter [1..65535]  # This container contains the configuaration (parameters) for events. | Note that this container definition does not explicitly define a symbolic name parameter. Instead, the short name of the container will be used in the Ecu Configuration Description to specify the symbolic name of the diagonstic event.
        integer DemEventId: 1..65535, set at pre-compile, symbolic-name-value=true  # Unique identifier of a diagnostic event. | This parameter should not be changeable by user, because the Id should be generated by Dem itself to prevent gaps and multiple use of an Id. The events should be sequentially ordered beginning with 1 and no gaps in between.
        enumeration DemEventKind: {DEM_EVENT_KIND_BSW, DEM_EVENT_KIND_SWC}, set at pre-compile  # This parameter is used to distinguish between SW-C and BSW events. SW-C events are reported by Dem_SetEventStatus API and BSW events are reported by Dem_ReportErrorStatus API.
        integer DemMaxNumberFreezeFrameRecords: 0..255, set at pre-compile  # This parameter defines the number of according freeze frame records, which can maximal be stored for this event. Therefore all these freeze frame records have the same freeze frame class. | This parameter is only required for calculated record numeration (refer to DemTypeOfFreezeFrameRecordNumeration).
        reference DemDTCClassRef [0..1]: set at pre-compile, destination=DemConfigSet/DemDTCClass  # This parameter defines the DTC configuration associated with the diagnostic event. | It is allowed to have events without a DTC (e.g. for ECU-internal events triggering safety reactions without being reported via diagnostic communication). The same DemDTCClass can be used from several events, to combine these (refer to chapter "Combination of diagonstic event").
        reference DemExtendedDataClassRef [0..1]: set at pre-compile, destination=DemGeneral/DemExtendedDataClass  # This reference defines the link to an extended data class sampler.
        reference DemFreezeFrameClassRef [0..1]: set at pre-compile, destination=DemGeneral/DemFreezeFrameClass  # These references define the links to a freeze frame class sampler.
        reference DemFreezeFrameRecNumClassRef: set at pre-compile, destination=DemGeneral/DemFreezeFrameRecNumClass  # This parameter defines the list of dedicated freeze frame record numbers associated with the diagnostic event. These record numbers are assigned to the freeze frame records (instead of calculated record numbers). | This parameter is only required for configured record numeration (refer to DemTypeOfFreezeFrameRecordNumeration).
        container DemCallbackClearEventAllowed [0..1]  # The presence of this container indicates that the Dem has access to a "ClearEventAllowed" callback. | In case there is a DemCallbackClearEventAllowedFnc, this parameter defines the name of the function that the Dem will call. In case there is no DemCallbackClearEventAllowedFnc, the Dem will have an R-Port requiring the interface CallbackClearEventAllowed whose name is generated by using the unique callback-prefix followed by the event name.
          function name DemCallbackClearEventAllowedFnc [0..1]: set at pre-compile  # Function name of prototype "ClearEventAllowed".
        container DemCallbackEventDataChanged [0..1]  # The presence of this container indicates that the Dem has access to an "EventDataChanged" callback. | In case there is a DemCallbackEventDataChangedFnc, this parameter defines the name of the function that the Dem will call. In case there is no DemCallbackEventDataChangedFnc, the Dem will have an R-Port requiring the interface CallbackEventDataChanged whose name is generated by using the unique callback-prefix followed by the event name.
          function name DemCallbackEventDataChangedFnc [0..1]: set at pre-compile  # Function name of prototype "EventDataChanged"
        container DemCallbackEventStatusChanged [0..*]  # The presence of this container indicates, that the Dem has access to an "EventStatusChanged" callback, which the Dem will call to notify other components about the change in the status of an event. | In case there is a DemCallbackEvenStatusChangedFnc, this parameter defines the name of the function that the Dem will call. In case there is no DemCallbackEvenStatusChangedFnc, the Dem will have an R-Port requiring the interface CallbackEventStatusChanged, whose name is generated by using the unique callback-prefix followed by the event name.
          function name DemCallbackEventStatusChangedFnc [0..1]: set at pre-compile  # Function name of prototype "EventStatusChanged"
        container DemCallbackInitMForE [0..1]  # The presence of this container indicates, that the Dem has access to an "InitMonitorForEvent" callback, which the Dem will call to initialize a monitor. | In case the container has a DemCallbackInitMForEFnc, this parameter defines the name of the function that the Dem will call. In case there is no DemCallbackInitMForEFnc, the Dem will have an R-Port requiring the interface CallbackInitMonitorForEvent, whose name is generated by using the unique callback-prefix followed by the event name.
          function name DemCallbackInitMForEFnc [0..1]: set at pre-compile  # Function name of prototype "InitMonitorForEvent".
        container DemEventClass  # This container contains the configuaration (parameters) for EventClass
          boolean DemAgingAllowed: set at pre-compile  # Switch to allow aging/unlearning of the event or not. | true: aging allowed false: aging not allowed
          integer DemAgingCycleCounterThreshold [0..1]: 1..256, set at pre-compile  # Number ot aging cycles needed to unlearn/delete the event.
          boolean DemConsiderPtoStatus: set at pre-compile  # This parameter is TRUE, when the event is affected by the Dem PTO handling.
          enumeration DemEventDestination [0..4]: {DEM_DTC_ORIGIN_MIRROR_MEMORY, DEM_DTC_ORIGIN_PRIMARY_MEMORY, DEM_DTC_ORIGIN_SECONDARY_MEMORY}, set at pre-compile  # The event destination assigns events to none, one or multiple origins. | If no event destination is assigned to a specific event, the event is handled internally and is not visible externally to the Dcm. If more than one event destination is assigned to a specific event, the event can be present in the corresponding origins.
          integer DemEventFailureCycleCounterThreshold [0..1]: 1..256, set at pre-compile  # Defines the number of failure cycles for the event based fault confirmation.
          enumeration DemEventOBDReadinessGroup: {DEM_OBD_RDY_AC, DEM_OBD_RDY_BOOSTPR, DEM_OBD_RDY_CAT, DEM_OBD_RDY_CMPRCMPT, DEM_OBD_RDY_EGSENS, DEM_OBD_RDY_ERG, DEM_OBD_RDY_EVAP, DEM_OBD_RDY_FLSYS, DEM_OBD_RDY_HCCAT, DEM_OBD_RDY_HTCAT, DEM_OBD_RDY_MISF, DEM_OBD_RDY_NONE, DEM_OBD_RDY_NOXCAT, DEM_OBD_RDY_O2SENS, DEM_OBD_RDY_O2SENSHT, DEM_OBD_RDY_PMFLT, DEM_OBD_RDY_SECAIR}, set at pre-compile  # This parameter specifies the Event OBD Readiness group for PID $01 and PID $41 computation. | This parameter is only applicable for emission-related ECUs.
          integer DemEventPriority: 1..256, set at pre-compile  # Priority of the event, in view of full event buffer.
          enumeration DemEventSignificance [0..1]: {DEM_EVENT_SIGNIFICANCE_FAULT, DEM_EVENT_SIGNIFICANCE_OCCURRENCE}, set at pre-compile  # Significance of the event, which indicates additional information concerning fault classification and resolution. | It can be mapped as Dem-internal data element. It shall be configured, if it is a part of event related data.
          boolean DemFFPrestorageSupported: set at pre-compile  # If this parameter is set to true, then the Prestorage of FreezeFrames is supported by the assigned event. This parameter is useful to calculate the buffer size.
          choice reference DemAgingCycleRef [0..1]: set at pre-compile, origin=AUTOSAR_ECUC V1.0.0, destination=[DemGeneral/DemAgingCycle, DemGeneral/DemOperationCycle]  # Reference to the cycle which is triggering the aging of the event. This can either be the same as the operation cycle of the event, or a separate aging cycle reported via API Dem_SetAgingCycleState. If external aging is configured (refer to DemAgingCycleCounterProcessing), this parameter is not used.
          reference DemEnableConditionGroupRef [0..1]: set at pre-compile, origin=AUTOSAR_ECUC V1.0.0, destination=DemGeneral/DemEnableConditionGroup  # References an enable condition group.
          reference DemEventFailureCycleRef [0..1]: set at pre-compile, origin=AUTOSAR_ECUC V1.0.0, destination=DemGeneral/DemOperationCycle  # Kind of failure cycle for the event based fault confirmation.
          reference DemOperationCycleRef: set at pre-compile, origin=AUTOSAR_ECUC V1.0.0, destination=DemGeneral/DemOperationCycle  # Kind of operation cycle for the event (e.g. power cycle, driving cycle, ...)
          reference DemStorageConditionGroupRef [0..1]: set at pre-compile, origin=AUTOSAR_ECUC V1.0.0, destination=DemGeneral/DemStorageConditionGroup  # References a storage condition group.
          choice container DemDebounceAlgorithmClass  # Debounce algorithm class: counter based, time based, or monitor internal.
            container DemDebounceCounterBased [0..1]  # This container contains the configuration (parameters) for counter based debouncing.
              integer DemDebounceCounterDecrementStepSize: 0..32768, set at pre-compile  # Defines the step size for decrementation of the internal fault detection counter (PREPASSED).
              integer DemDebounceCounterFailedThreshold: 0..32767, set at pre-compile  # Defines the value of the internal fault detection counter, which indicates the failed status.
              integer DemDebounceCounterIncrementStepSize: 0..32767, set at pre-compile  # Defines the step size for incrementation of the internal fault detection counter (PREFAILED).
              boolean DemDebounceCounterJumpDown: set at pre-compile  # Switch for the activation of Jump-Down. | true: Jump-Down activated false: Jump-Down deactivated
              integer DemDebounceCounterJumpDownValue: -32768..32767, set at pre-compile  # Jump-Down value of the internal fault detection counter.
              boolean DemDebounceCounterJumpUp: set at pre-compile  # Switch for the activation of Jump-Up. | true: Jump-Up activated false: Jump-Up deactivated
              integer DemDebounceCounterJumpUpValue: -32768..32767, set at pre-compile  # Jump-Up value of the internal fault detection counter.
              integer DemDebounceCounterPassedThreshold: -32768..0, set at pre-compile  # Defines the value of the internal fault detection counter, which indicates the passed status.
            container DemDebounceMonitorInternal [0..1]  # This container contains the configuration (parameters) for monitor internal debouncing.
              container DemCallbackGetFDC [0..1]  # The presence of this container indicates, that the Dem has access to a "GetFaultDetectionCounter" callback, which the Dem will call to obtain the value of the fault detection counter. | In case the container has a DemCallbackGetFDCFnc, this parameter defines the name of the function that the Dem will call. In case there is no DemCallbackGetFDCFnc, the Dem will have a R-Port requiring the interface CallbackGetFaultDetectionCounter, whose name is generated by using the unique callback-prefix followed by the event name.
                function name DemCallbackGetFDCFnc [0..1]: set at pre-compile  # Function name of prototype "GetFaultDetectionCounter".
            container DemDebounceTimeBase [0..1]  # This container contains the configuration (parameters) for time based debouncing.
              float DemDebounceTimeFailedThreshold: 0..3600, set at pre-compile  # Defines the time out duration for "Event Failed" qualification. | The AUTOSAR configuration standard is to use SI units, so this parameter is defined as float value in seconds. Dem configuration tools must convert this float value to the appropriate value format for the use in the software implementation of Dem.
              float DemDebounceTimePassedThreshold: 0..3600, set at pre-compile  # Defines the time out duration for "Event Passed" qualification. | The AUTOSAR configuration standard is to use SI units, so this parameter is defined as float value in seconds. Dem configuration tools must convert this float value to the appropriate value format for the use in the software implementation of Dem.
          container DemIndicatorAttribute [0..255]  # This container contains the event specific configuration of Indicators.
            enumeration DemIndicatorBehaviour: {DEM_INDICATOR_BLINKING, DEM_INDICATOR_BLINK_CONT, DEM_INDICATOR_CONTINUOUS}, set at post-build in variant post-build / pre-compile in variant pre-compile  # Behaviour of the linked indicator
            integer DemIndicatorFailureCycleCounterThreshold [0..1]: 0..255, set at pre-compile  # Defines the number of failure cycles for the WarningIndicatorOnCriteria.
            enumeration DemIndicatorFailureCycleSource: {DEM_FAILURE_CYCLE_EVENT, DEM_FAILURE_CYCLE_INDICATOR}, set at pre-compile  # This parameter defines, which failure cycle is used for the WarningIndicatorOnCriteria handling.
            integer DemIndicatorHealingCycleCounterThreshold: 0..255, set at pre-compile  # Defines the number of healing cycles for the WarningIndicatorOffCriteria.
            reference DemIndicatorFailureCycleRef [0..1]: set at pre-compile, destination=DemGeneral/DemOperationCycle  # Kind of failure cycle for the indicator controlled by the according event used for the WarningIndicatorOnCriteria.
            reference DemIndicatorHealingCycleRef: set at pre-compile, destination=DemGeneral/DemOperationCycle  # Kind of healing cycle for the indicator controlled by the according event used for the WarningIndicatorOffCriteria.
            reference DemIndicatorRef: set at pre-compile, destination=DemGeneral/DemIndicator  # Reference to the used indicator.
      container DemPidClass [0..255]  # This container contains the different PIDs for the single global OBD relevant freeze frame class. It is assembled out of one or several data elements.
        integer DemPidIdentifier: 0..255, set at post-build in variant post-build / pre-compile in variant pre-compile  # identifier of the PID
        container DemPidDataElement [1..255]  # This container contains the different data elements contained in the specific PID.
          choice reference DemPidDataElementClassRef: set at post-build in variant post-build / pre-compile in variant pre-compile, destination=[DemDataElementClass/DemExternalCSDataElementClass, DemDataElementClass/DemExternalSRDataElementClass, DemDataElementClass/DemInternalDataElementClass]  # This reference contains the link to a data element class.
    container DemGeneral  # This container contains the configuration (parameters) of the BSW Dem
      enumeration DemAgingCycleCounterProcessing: {DEM_PROCESS_AGINGCTR_EXTERN, DEM_PROCESS_AGINGCTR_INTERN}, set at pre-compile  # This configuration switch defines, whether the aging counter is calculated Dem-internally or provided via Dem_SetAgingCycleCounterValue.
      integer DemBswErrorBufferSize: 0..255, set at pre-compile  # Maximum number of elements in buffer for handling of BSW errors (ref. to Dem107).
      enumeration DemClearDTCBehavior: {DEM_CLRRESP_NONVOLATILE_FINISH, DEM_CLRRESP_NONVOLATILE_TRIGGER, DEM_CLRRESP_VOLATILE}, set at pre-compile  # Defines the clearing process of diagnostic information for volatile and non-volatile memory and the positive response handling for the Dcm module.
      boolean DemDTCSuppressionSupport: set at pre-compile  # This configuration switch defines, whether support for DTC suppression is enabled or not. | true: DTC suppression support is enabled false: DTC suppression support is disabled
      boolean DemDebounceCounterBasedSupport: set at pre-compile  # This configuration switch defines, whether support for counter based debouncing is enabled or not. | true: counter based debouncing support is enabled false: counter based debouncing support is disabled
      boolean DemDebounceTimeBasedSupport: set at pre-compile  # This configuration switch defines, whether support for time based debouncing is enabled or not. | true: time based debouncing support is enabled false: time based debouncing support is disabled
      boolean DemDevErrorDetect: set at pre-compile  # Activate/Deactivate the Development Error Detection and Notification. | true: Development Error Detection and Notification activated false: Development Error Detection and Notification deactivated
      integer DemDtcStatusAvailabilityMask: 0..255, set at pre-compile  # Mask for the supported DTC status bits by the Dem. This mask is used by UDS service 0x19.
      boolean DemEnableConditionSupport: set at pre-compile  # This configuration switch defines, whether support for enable conditions is enabled or not. | true: support for enable conditions is enabled false: support for enable conditions is disabled
      enumeration DemEventCombinationSupport: {DEM_EVCOMB_DISABLED, DEM_EVCOMB_TYPE1, DEM_EVCOMB_TYPE2}, set at pre-compile  # This parameter defines the type of event combination supported by the Dem.
      boolean DemEventDisplacementSupport: set at pre-compile  # This configuration switch defines, whether support for event displacement is enabled or not. | true: event displacement support is enabled false: event displacement support is disabled
      enumeration DemExtendedDataCapture [0..1]: {DEM_TRIGGER_EVENT_MEMORY_STORAGE, DEM_TRIGGER_TESTFAILED}, set at pre-compile  # This parameter defines the point in time, when the extended data collection is done for the initial event memory entry.
      enumeration DemFreezeFrameCapture [0..1]: {DEM_TRIGGER_EVENT_MEMORY_STORAGE, DEM_TRIGGER_TESTFAILED}, set at pre-compile  # This parameter defines the point in time, when the freeze frame data collection is done for the initial event memory entry.
      string DemHeaderFileInclusion [0..*]: set at pre-compile, regular-expression=[a-zA-Z0-9_]([a-zA-Z0-9\._])*  # Name of the header file(s) to be included by the Dem module containing the used C-callback declarations.
      integer DemImmediateNvStorageLimit [0..1]: 1..255, set at pre-compile  # This parameter defines the maximum number of occurrences, a specific event memory entry is allowed, to be stored in NVRAM immediately (refer to DemImmediateNvStorage).
      integer DemMaxNumberEventEntryMirror: 0..255, set at pre-compile  # Maximum number of events which can be stored in the mirror memory
      integer DemMaxNumberEventEntryPermanent: 0..255, set at pre-compile  # Maximum number of events which can be stored in the permanent memory. | The assignment of an event to this memory type is dynamic and used for emission-related events only.
      integer DemMaxNumberEventEntryPrimary: 1..255, set at pre-compile  # Maximum number of events which can be stored in the primary memory
      integer DemMaxNumberEventEntrySecondary: 0..255, set at pre-compile  # Maximum number of events which can be stored in the secondary memory
      integer DemMaxNumberPrestoredFF: 0..255, set at pre-compile  # Defines the maximum number for prestored freeze frames. | If set to 0, then freeze frame prestorage is not supported by the ECU.
      boolean DemOBDSupport: set at pre-compile  # This configuration switch defines whether OBD is supported or not
      enumeration DemOccurrenceCounterProcessing: {DEM_PROCESS_OCCCTR_CDTC, DEM_PROCESS_OCCCTR_TF}, set at pre-compile  # This configuration switch defines the consideration of the fault confirmation process for the occurrence counter. For OBD and mixed systems (OBD/non OBD, refer to DemOBDSupport) the fault confirmation process must not be considered.
      enumeration DemOperationCycleProcessing: {DEM_PROCESS_OPCYC_COUNTER, DEM_PROCESS_OPCYC_STATE}, set at pre-compile  # This configuration switch defines, whether the operation cycles are triggered by DEM_CYCLE_STATE_START or collecting an external counter value, which results in respective state changes.
      boolean DemOperationCycleStatusStorage: set at pre-compile  # Defines if the operation cycle state is available over the power cycle (stored non-volatile) or not. | true: the operation cycle state is stored non-volatile false: the operation cycle state is only stored volatile
      boolean DemPTOSupport: set at pre-compile  # This configuration switch defines, whether PTO support (and therefore PID $1E support) is enabled or not.
      enumeration DemStatusBitHandlingTestFailedSinceLastClear: {DEM_STATUS_BIT_AGING_AND_DISPLACEMENT, DEM_STATUS_BIT_NORMAL}, set at pre-compile  # This configuration switch defines, whether the aging and displacement mechanism shall be applied to the "TestFailedSinceLastClear" status bits.
      boolean DemStatusBitStorageTestFailed: set at pre-compile  # Activate/Deactivate the permanent storage of the "TestFailed" status bits. | true: storage activated false: storage deactivated
      boolean DemStorageConditionSupport: set at pre-compile  # This configuration switch defines, whether support for storage conditions is enabled or not. | true: support for storage conditions is enabled false: support for storage conditions is disabled
      float DemTaskTime: 0..0.1, set at pre-compile, origin=AUTOSAR_ECUC V1.0.0  # Allow to configure the time for the periodic cyclic task. Please note: This configuration value shall be equal to the value in the Basic Software Scheduler configuration of the RTE module. | The AUTOSAR configuration standard is to use SI units, so this parameter is defined as float value in seconds. Dem configuration tools must convert this float value to the appropriate value format for the use in the software implementation of Dem. min: A negative value is not allowed. max: After event status was reported, processing shall be completed within 100ms in order to have the fault entry status information updated as soon as possible (e.g. for PID $01). upperMultiplicity: Exactly one TaskTime must be specified per configuration. lowerMultiplicity: Exactly one TaskTime must be specified per configuration.
      boolean DemTriggerDcmReports: set at pre-compile  # Activate/Deactivate the notification to the Diagnostic Communication Manager for ROE processing. | true: Dcm ROE notification activated false: Dcm ROE notification deactivated
      boolean DemTriggerDltReports: set at pre-compile  # Activate/Deactivate the notification to the Diagnostic Log and Trace. | true: Dlt notification activated false: Dlt notification deactivated
      boolean DemTriggerFiMReports: set at pre-compile  # Activate/Deactivate the notification to the Funciton Inhibition Manager. | true: FiM notification activated false: FiM notification deactivated
      boolean DemTriggerMonitorInitBeforeClearOk: set at pre-compile  # Defines if the monitor re-initialization has to be triggered before or after the Dem module returns DEM_CLEAR_OK. | true: trigger re-initialization before DEM_CLEAR_OK false: trigger re-initialization after DEM_CLEAR_OK
      enumeration DemTypeOfDTCSupported: {DEM_DTC_TRANSLATION_ISO11992_4, DEM_DTC_TRANSLATION_ISO14229_1, DEM_DTC_TRANSLATION_ISO15031_6, DEM_DTC_TRANSLATION_SAEJ1939_73}, set at pre-compile  # This parameter defines the format returned by Dem_GetTranslationType and does not relate to/influence the supported Dem functionality.
      enumeration DemTypeOfFreezeFrameRecordNumeration: {DEM_FF_RECNUM_CALCULATED, DEM_FF_RECNUM_CONFIGURED}, set at pre-compile  # This parameter defines the type of assigning freeze frame record numbers for event-specific freeze frame records.
      boolean DemVersionInfoApi: set at pre-compile  # Activate/Deactivate the version information API. | true: version information activated false: version information deactivated
      reference DemMILIndicatorRef [0..1]: set at pre-compile, destination=DemGeneral/DemIndicator  # This parameter defines the indicator representing the MIL. | This paramteter is mandatory for ECUs supporting OBD (refer to DemOBDSupport).
      container DemAgingCycle [0..256]  # Note that this container definition does not explicitly define a symbolic name parameter. Instead, the short name of the container will be used in the Ecu Configuration Description to specify the symbolic name of the aging cycle name. These aging cycles are reported via API Dem_SetAgingCycleState only.
      container DemCallbackDTCStatusChanged [0..*]  # The presence of this container indicates, that the Dem has access to a "DTCStatusChanged" callback, which the Dem will call to notify other components about the change in the status of a DTC. | In case there is a DemCallbackDTCStatusChangedFnc, this parameter defines the name of the function that the Dem will call. In case there is no DemCallbackDTCStatusChangedFnc, the Dem will have an R-Port requiring the interface CallbackDTCStatusChanged whose name is generated by using the unique callback-prefix followed by the event name.
        function name DemCallbackDTCStatusChangedFnc [0..1]: set at pre-compile  # Function name of prototype "DTCStatusChanged". | Note: If the parameter DemTriggerDcmReports is enabled, this parameter shall not be "Dcm_DemTriggerOnDTCStatus".
      choice container DemDataElementClass [0..255]  # This container contains the configuration (parameters) for an internal/external data element class.
        container DemExternalCSDataElementClass [0..1]  # This container contains the configuration (parameters) for an external client/server based data element class. | It defines, how the Dem can obtain the value of the data element from either a SW-C or another BSW module. Whether a client/server port or a C function-call is used, is defined by DemDataElementUsePort.
          integer DemDataElementDataSize: 1..255, set at pre-compile  # Defines the size of the data element in bytes.
          function name DemDataElementReadFnc [0..1]: set at pre-compile  # In case of DemDataElementUsePort is false, this parameter defines the prototype of the C function "ReadDataElement" used to get the according value.
          boolean DemDataElementUsePort: set at pre-compile  # If the parameter is set to True, a R-Port is generated, to obtain the data element (interface DataServices_<SyncDataElement>). | If the parameter is set to False, the information is obtained by C function-call on another BSW module specified by the parameter DemDataElementReadFnc.
        container DemExternalSRDataElementClass [0..1]  # This container contains the configuration (parameters) for an external sender/receiver based data element class. It defines, how the Dem can obtain the value of the data element from a SW-C, by using a sender/receiver port.
          integer DemDataElementDataSize: 1..255, set at pre-compile  # Defines the size of the data element in bits.
          instance reference DemDataElementInstanceRef: set at pre-compile, destination-context=ROOT-SW-COMPOSITION-PROTOTYP SW-COMPONENT-PROTOTYPE+ PORT-PROTOTYPE, destination-type=VARIABLE-DATA-PROTOTYPE  # Instance Reference to the actual OperationPrototype which shall be traced.
        container DemInternalDataElementClass [0..1]  # This container contains the configuration (parameters) for an internal data element class.
          integer DemDataElementDataSize: 1..255, set at pre-compile  # Defines the size of the data element in bytes.
          enumeration DemInternalDataElement: {DEM_AGINGCTR, DEM_OCCCTR, DEM_OVFLIND, DEM_SIGNIFICANCE}, set at pre-compile  # This parameter defines the Dem-internal data value, which is mapped to the data element.
      container DemDidClass [0..255]  # This container contains the configuration (parameters) for a data Id class. It is assembled out of one or several data elements.
        integer DemDidIdentifier: 0..65535, set at pre-compile  # Identifier of the Data ID.
        choice reference DemDidDataElementClassRef [1..255]: set at pre-compile, destination=[DemDataElementClass/DemExternalCSDataElementClass, DemDataElementClass/DemExternalSRDataElementClass, DemDataElementClass/DemInternalDataElementClass]  # This reference contains the link to a data element class.
      container DemEnableCondition [0..255]  # This container contains the configuration (parameters) for enable conditions.
        integer DemEnableConditionId: 0..255, set at pre-compile, symbolic-name-value=true  # Defines a unique enable condition Id. | This parameter should not be changeable by user, because the Id should be generated by Dem itself to prevent gaps and multiple use of an Id. The enable conditions should be sequentially ordered beginning with 0 and no gaps in between.
        boolean DemEnableConditionStatus: set at pre-compile  # Defines the inital status for enable or disable of acceptance of event reports of a diagnostic event. | The value is the initialization after power up (before this condition is reported the first time). true: acceptance of a diagnostic event enabled false: acceptance of a diagnostic event disabled
      container DemEnableConditionGroup [0..255]  # This container contains the configuration (parameters) for enable condition groups.
        reference DemEnableConditionRef [1..255]: set at pre-compile, origin=AUTOSAR_ECUC V1.0.0, destination=DemGeneral/DemEnableCondition  # References an enable condition.
      container DemExtendedDataClass [0..*]  # This class contains the combinations of extended data records for an extended data class.
        reference DemExtendedDataRecordClassRef [1..253]: set at pre-compile, destination=DemGeneral/DemExtendedDataRecordClass  # This reference contains the link to an extended data class record.
      container DemExtendedDataRecordClass [0..253]  # This container contains the configuration (parameters) for an extended data record class. | It is assembled out of one or several data elements.
        integer DemExtendedDataRecordNumber: 0..253, set at pre-compile  # This configuration parameter specifies an unique identifier for an extended data record. | One or more extended data records can be assigned to one diagnostic event/DTC. 0xFF and 0xFE are resereved by ISO (therefore the maximal value equals 253).
        enumeration DemExtendedDataRecordUpdate [0..1]: {DEM_UPDATE_RECORD_NO, DEM_UPDATE_RECORD_YES}, set at pre-compile  # This parameter defines the case, when the extended data record is stored/updated.
        choice reference DemDataElementClassRef [1..255]: set at pre-compile, destination=[DemDataElementClass/DemExternalCSDataElementClass, DemDataElementClass/DemExternalSRDataElementClass, DemDataElementClass/DemInternalDataElementClass]  # This reference contains the link to a data element class.
      container DemFreezeFrameClass [0..255]  # This container contains the combinations of DIDs for a non OBD relevant freeze frame class.
        reference DemDidClassRef [1..255]: set at pre-compile, destination=DemGeneral/DemDidClass  # For OBD relevant data | Multiple PIDs can be relevant per freeze frame.
      container DemFreezeFrameRecNumClass [0..255]  # This container contains a list of dedicated, different freeze frame record numbers assigned to an event. The order of record numbers in this list is assigned to the chronological order of the according freeze frame records. | dependency: DemTypeOfFreezeFrameRecordNumeration
        integer DemFreezeFrameRecordNumber [1..254]: 1..254, set at pre-compile  # This parameter defines a record number for a freeze frame record. This record number is unique per freeze frame record number class. | The range of this value is defined by ISO 14229-1 (0x01 .. 0xFE).
      container DemGeneralOBD [0..1]  # This container contains the general OBD-specific configuration (parameters) of the Dem module.
        choice reference DemOBDInputAcceleratorPaddleInformation: set at pre-compile, destination=[DemDataElementClass/DemExternalCSDataElementClass, DemDataElementClass/DemExternalSRDataElementClass]  # Input variable for the accelerator paddle information, which is assigned to a specific data element used as interface for the Dem-internal PID calculations.
        choice reference DemOBDInputAmbientPressure: set at pre-compile, destination=[DemDataElementClass/DemExternalCSDataElementClass, DemDataElementClass/DemExternalSRDataElementClass]  # Input variable for the ambient pressure, which is assigned to a specific data element used as interface for the Dem-internal PID calculations.
        choice reference DemOBDInputAmbientTemperature: set at pre-compile, destination=[DemDataElementClass/DemExternalCSDataElementClass, DemDataElementClass/DemExternalSRDataElementClass]  # Input variable for the ambient temperature, which is assigned to a specific data element used as interface for the Dem-internal PID calculations.
        choice reference DemOBDInputDistanceInformation: set at pre-compile, destination=[DemDataElementClass/DemExternalCSDataElementClass, DemDataElementClass/DemExternalSRDataElementClass]  # Input variable for the distance information, which is assigned to a specific data element used as interface for the Dem-internal PID calculations.
        choice reference DemOBDInputEngineSpeed: set at pre-compile, destination=[DemDataElementClass/DemExternalCSDataElementClass, DemDataElementClass/DemExternalSRDataElementClass]  # Input variable for the engine speed, which is assigned to a specific data element used as interface for the Dem-internal PID calculations.
        choice reference DemOBDInputEngineTemperature: set at pre-compile, destination=[DemDataElementClass/DemExternalCSDataElementClass, DemDataElementClass/DemExternalSRDataElementClass]  # Input variable for the engine temperature, which is assigned to a specific data element used as interface for the Dem-internal PID calculations.
        choice reference DemOBDInputProgrammingEvent: set at pre-compile, destination=[DemDataElementClass/DemExternalCSDataElementClass, DemDataElementClass/DemExternalSRDataElementClass]  # Input variable for the programming event, which is assigned to a specific data element used as interface for the Dem-internal PID calculations.
        choice reference DemOBDInputVehicleSpeed: set at pre-compile, destination=[DemDataElementClass/DemExternalCSDataElementClass, DemDataElementClass/DemExternalSRDataElementClass]  # Input variable for the vehicle speed, which is assigned to a specific data element used as interface for the Dem-internal PID calculations.
      container DemGroupOfDTC [0..255]  # This container contains the configuaration (parameters) for DTC groups.
        integer DemGroupDTCs: 0..16777214, set at pre-compile, symbolic-name-value=true  # DTC value of the selected group of DTC | (Range: 3 byte, 0x000000 is only available for the emission-related DTC group, 0xFFFFFF is reserved for 'all DTCs', according to ISO14229-1 Annex D.1,) The DTC group 'all DTCs' is always available and will not be configured.
      container DemIndicator [0..255]  # This container contains the configuration (parameters) for Indicators. | Note that this container definition does not explicitly define a symbolic name parameter. Instead, the short name of the container will be used in the Ecu Configuration Description to specify the symbolic name of the INDICATOR_NAME.
        integer DemIndicatorID: 0..255, set at pre-compile, symbolic-name-value=true  # Unique identifier of an indicator.
      container DemNvRamBlockId [0..*]  # This container contains the configuaration (parameters) for a non-volatile memory block, which is used from the Dem. If no permanent storage of event memory entries is required, no block needs to be configured. | The number of blocks which are necessary depends on the implementation and configuration (e.g. number of used event memories) of the Dem module.
        symbolic name reference DemNvRamBlockIdRef: set at pre-compile, origin=AUTOSAR_ECUC V1.0.0, destination=NvMBlockDescriptor  # This reference contains the link to a non-volatile memory block. For post build time configurations worst case szenario shall be used.
      container DemOperationCycle [1..256]  # Note that this container definition does not explicitly define a symbolic name parameter. Instead, the short name of the container will be used in the Ecu Configuration Description to specify the symbolic name of the operation cycle name.
        enumeration DemOperationCycleType: {DEM_OPCYC_IGNITION, DEM_OPCYC_OBD_DCY, DEM_OPCYC_OTHER, DEM_OPCYC_POWER, DEM_OPCYC_TIME, DEM_OPCYC_WARMUP}, set at pre-compile  # Operation cycles types for the Dem to be supported by cycle-state APIs. | Further cycle types can be specified as part of the Dem delivery.
      container DemRatioId [0..65535]  # This container contains the OBD specific ratio Id configuraiton. It is related to a specific event, a FID, and an IUMPR group. | Note that this container definition does not explicitly define a symbolic name parameter. Instead, the short name of the container will be used in the Ecu Configuration Description to specify the symbolic name of the ratio Id name.
        enumeration DemIUMPRGroup: {DEM_IUMPR_BOOSTPRS, DEM_IUMPR_CAT1, DEM_IUMPR_CAT2, DEM_IUMPR_EGR, DEM_IUMPR_EGSENSOR, DEM_IUMPR_EVAP, DEM_IUMPR_NMHCCAT, DEM_IUMPR_NOXADSORB, DEM_IUMPR_NOXCAT, DEM_IUMPR_OXS1, DEM_IUMPR_OXS2, DEM_IUMPR_PMFILTER, DEM_IUMPR_PRIVATE, DEM_IUMPR_SAIR, DEM_IUMPR_SECOXS1, DEM_IUMPR_SECOXS2}, set at pre-compile  # This parameter specifies the assigned IUMPR group of the ratio Id.
        enumeration DemRatioIdType: {DEM_RATIO_API, DEM_RATIO_OBSERVER}, set at pre-compile  # This parameter defines whether the ratio Id will be calculated API or observer based.
        reference DemDiagnosticEventRef: set at pre-compile, destination=DemConfigSet/DemEventParameter  # This reference contains the link to a diagnostic event.
        symbolic name reference DemFunctionIdRef: set at pre-compile, destination=FiMFID  # This reference contains the link to a function identifier within the FiM which is used as a primary FID.
        symbolic name reference DemSecondaryFunctionIdRef [0..*]: set at pre-compile, destination=FiMFID  # This reference contains the link to a function identifier within the FiM which is used as a secondary FID. | The "primary" and all "secondary" FID inhibitions are combined by "OR".
      container DemStorageCondition [0..255]  # This container contains the configuration (parameters) for storage conditions.
        integer DemStorageConditionId: 0..255, set at pre-compile, symbolic-name-value=true  # Defines a unique storage condition Id. This parameter should not be changeable by user, because the Id should be generated by Dem itself to prevent gaps and multiple use of an Id. The storage conditions should be sequentially ordered beginning with 0 and no gaps in between.
        boolean DemStorageConditionStatus: set at pre-compile  # Defines the initial status for enable or disable of storage of a diagnostic event. | The value is the initialization after power up (before this condition is reported the first time). true: storage of a diagnostic event enabled false: storage of a diagnostic event disabled
      container DemStorageConditionGroup [0..255]  # This container contains the configuration (parameters) for storage condition groups.
        reference DemStorageConditionRef [1..255]: set at pre-compile, origin=AUTOSAR_ECUC V1.0.0, destination=DemGeneral/DemStorageCondition  # References an enable condition.
package /AUTOSAR_Dem/EcuModuleDefs
  module definition Dem [0..1]: refined-module-def=EcucDefs/Dem, variants post-build/pre-compile  # Configuration of the Dem (Diagnostic Event Manager) module.
    container DemConfigSet: multiple-configuration-container=true  # This container contains the configuration parameters and sub containers of the Dem module supporting multiple configuration sets. This container is a MultipleConfigurationContainer, i.e. this container and its sub-containers exist once per configuration set.
      container DemDTCClass [0..65535]  # This container contains the configuration (parameters) for DTCClass.
        integer DemDTCFunctionalUnit: 0..255, set at pre-compile  # DTCFuncitonalUnit is a 1-byte value which identifies the corresponding basic vehicle / system function which reports the DTC. This parameter is necessary for the report of severity informations.
        enumeration DemDTCSeverity [0..1]: {DEM_DTC_SEV_CHECK_AT_NEXT_HALT, DEM_DTC_SEV_IMMEDIATELY, DEM_DTC_SEV_MAINTENANCE_ONLY, DEM_DTC_SEV_NO_SEVERITY}, set at pre-compile  # DTC severity | This parameter depends on automotive manufacturer and is optional.
        boolean DemImmediateNvStorage: set at pre-compile  # Switch to enable immediate storage triggering of an according event memory entriy persistently to NVRAM. | true: immediate non-volatile storage triggering enabled false: immediate non-volatile storage triggering disabled
        integer DemObdDTC [0..1]: 1..65535, set at post-build in variant post-build / pre-compile in variant pre-compile  # Unique Diagnostic Trouble Code value for OBD
        integer DemUdsDTC [0..1]: 1..16777214, set at post-build in variant post-build / pre-compile in variant pre-compile  # Unique Diagnostic Trouble Code value for UDS | (Range: 0x000000 and 0xFFFFFF are reserved for DTC groups by ISO 14229-1)
        enumeration DemDTCKind: {DEM_DTC_KIND_ALL_DTCS, DEM_DTC_KIND_EMISSION_REL_DTCS}  # This one is here from old autosar versions to make the service need transformer work. It serves no functional purpose.
        integer DemDTC: 1..16777214, set at post-build in variant post-build / pre-compile in variant pre-compile  # Diagnostic Trouble Code value | (Range: 0x000000 and 0xFFFFFF are reserved for DTC groups by ISO 14229-1)
        string DcnfxmlFileSource [0..*]
        container DemCallbackInitMForF [0..*]  # The presence of this container indicates, that the Dem has access to an "InitMonitorForFunction" callback, which the Dem will call to initialize a monitor. | In case the container has a DemCallbackInitMForFFnc, this parameter defines the name of the function that the Dem will call. In case there is no DemCallbackInitMForFFnc, the Dem will have an R-Port requiring the interface CallbackInitMonitorForFunction, whose name is generated by using the unique callback-prefix followed by the event name.
          function name DemCallbackInitMForFFnc [0..1]: set at pre-compile  # Function name of prototype "InitMonitorForFunction".
          reference PartitionRef [0..1]: destination=EcucPartition
          choice container DemCallbackInitMForFBackRef [0..1]
            container DemCallbackInitMForFSWC [0..1]
              instance reference DemCallbackInitMForFSwcInternalBehaviorRef: origin=ServiceNeeds_UseCase_Realization, destination-context=ROOT-SW-COMPOSITION-PROTOTYPE SW-COMPONENT-PROTOTYPE, destination-type=SWC-INTERNAL-BEHAVIOR
              foreign reference DemCallbackInitMForFSwcServiceDependencyRef: origin=ServiceNeeds_UseCase_Realization, destination-type=SWC-SERVICE-DEPENDENCY
            container DemCallbackInitMForFBSW [0..1]
              foreign reference DemCallbackInitMForFDiagnosticEventNeedsRef: origin=ServiceNeeds_UseCase_Realization, destination-type=DIAGNOSTIC-EVENT-NEEDS
      container DemEventParameter [1..65535]  # This container contains the configuaration (parameters) for events. | Note that this container definition does not explicitly define a symbolic name parameter. Instead, the short name of the container will be used in the Ecu Configuration Description to specify the symbolic name of the diagonstic event.
        integer DemEventId: 1..65535, set at pre-compile, symbolic-name-value=true  # Unique identifier of a diagnostic event. | This parameter should not be changeable by user, because the Id should be generated by Dem itself to prevent gaps and multiple use of an Id. The events should be sequentially ordered beginning with 1 and no gaps in between.
        enumeration DemEventKind: {DEM_EVENT_KIND_BSW, DEM_EVENT_KIND_SWC, DEM_EVENT_KIND_ERRM4, DEM_EVENT_KIND_ERRM6, DEM_EVENT_KIND_UDGI, DEM_EVENT_KIND_CUS}, set at pre-compile  # This parameter is used to distinguish between SW-C and BSW events. SW-C events are reported by Dem_SetEventStatus API and BSW events are reported by Dem_ReportErrorStatus API.
        integer DemMaxNumberFreezeFrameRecords: 0..255, set at pre-compile  # This parameter defines the number of according freeze frame records, which can maximal be stored for this event. Therefore all these freeze frame records have the same freeze frame class. | This parameter is only required for calculated record numeration (refer to DemTypeOfFreezeFrameRecordNumeration).
        string DemEventDescription [0..1]
        string DemEventSource [0..*]
        boolean DemErrmSimilarConditions [0..1]  # This diagnostics uses similar conditions.
        string DemErrmSymptomCallbackReset [0..1]
        string DemErrmSymptomCallbackGetSdr [0..1]
        string DemErrmPrmNrConf [0..1]
        boolean DemErrmArrayAccessSuppressed [0..1]
        string DemEventHierarchyName [0..1]
        string DemEventDisplayName [0..1]  # May contain an element specific more human-readable name to substitute the shortname
        string DemEventModuleName [0..1]
        string DemEventPureFunctionName [0..1]
        boolean DemEventAvailableCnf [0..1]
        string DcnfxmlFileSource [0..*]
        reference DemDTCClassRef [0..1]: set at pre-compile, destination=DemConfigSet/DemDTCClass  # This parameter defines the DTC configuration associated with the diagnostic event. | It is allowed to have events without a DTC (e.g. for ECU-internal events triggering safety reactions without being reported via diagnostic communication). The same DemDTCClass can be used from several events, to combine these (refer to chapter "Combination of diagonstic event").
        reference DemExtendedDataClassRef [0..1]: set at pre-compile, destination=DemGeneral/DemExtendedDataClass  # This reference defines the link to an extended data class sampler.
        reference DemFreezeFrameClassRef [0..1]: set at pre-compile, destination=DemGeneral/DemFreezeFrameClass  # These references define the links to a freeze frame class sampler.
        reference DemFreezeFrameRecNumClassRef: set at pre-compile, destination=DemGeneral/DemFreezeFrameRecNumClass  # This parameter defines the list of dedicated freeze frame record numbers associated with the diagnostic event. These record numbers are assigned to the freeze frame records (instead of calculated record numbers). | This parameter is only required for configured record numeration (refer to DemTypeOfFreezeFrameRecordNumeration).
        symbolic name reference DemInhibitedByFunctionIdRef [0..*]: set at pre-compile, destination=FiMFID  # This reference contains the link to a function identifier within the FiM.
        symbolic name reference DemInhibitedSecondaryByFunctionIdRef [0..*]: destination=FiMFID
        symbolic name reference DemValidatedByFunctionIdRef [0..*]: set at pre-compile, destination=FiMFID  # This reference contains the link to a function identifier within the FiM which is used by the monitor before deliverying a result.
        container DemCallbackClearEventAllowed [0..1]  # The presence of this container indicates that the Dem has access to a "ClearEventAllowed" callback. | In case there is a DemCallbackClearEventAllowedFnc, this parameter defines the name of the function that the Dem will call. In case there is no DemCallbackClearEventAllowedFnc, the Dem will have an R-Port requiring the interface CallbackClearEventAllowed whose name is generated by using the unique callback-prefix followed by the event name.
          function name DemCallbackClearEventAllowedFnc [0..1]: set at pre-compile  # Function name of prototype "ClearEventAllowed".
          reference PartitionRef [0..1]: destination=EcucPartition
          choice container DemCallbackClearEventAllowedBackRef [0..1]
            container DemCallbackClearEventAllowedSWC [0..1]
              instance reference DemCallbackClearEventAllowedSwcInternalBehaviorRef: origin=ServiceNeeds_UseCase_Realization, destination-context=ROOT-SW-COMPOSITION-PROTOTYPE SW-COMPONENT-PROTOTYPE, destination-type=SWC-INTERNAL-BEHAVIOR
              foreign reference DemCallbackClearEventAllowedSwcServiceDependencyRef: origin=ServiceNeeds_UseCase_Realization, destination-type=SWC-SERVICE-DEPENDENCY
            container DemCallbackClearEventAllowedBSW [0..1]
              foreign reference DemCallbackClearEventAllowed: origin=ServiceNeeds_UseCase_Realization, destination-type=DIAGNOSTIC-EVENT-NEEDS
        container DemCallbackEventDataChanged [0..1]  # The presence of this container indicates that the Dem has access to an "EventDataChanged" callback. | In case there is a DemCallbackEventDataChangedFnc, this parameter defines the name of the function that the Dem will call. In case there is no DemCallbackEventDataChangedFnc, the Dem will have an R-Port requiring the interface CallbackEventDataChanged whose name is generated by using the unique callback-prefix followed by the event name.
          function name DemCallbackEventDataChangedFnc [0..1]: set at pre-compile  # Function name of prototype "EventDataChanged"
          choice container DemCallbackEventDataChangedBackRef [0..1]
            container DemCallbackEventDataChangedSWC [0..1]
              instance reference DemCallbackEventDataChangedSwcInternalBehaviorRef: origin=ServiceNeeds_UseCase_Realization, destination-context=ROOT-SW-COMPOSITION-PROTOTYPE SW-COMPONENT-PROTOTYPE, destination-type=SWC-INTERNAL-BEHAVIOR
              foreign reference DemCallbackEventDataChangedSwcServiceDependencyRef: origin=ServiceNeeds_UseCase_Realization, destination-type=SWC-SERVICE-DEPENDENCY
            container DemCallbackEventDataChangedBSW [0..1]
              foreign reference DemCallbackEventDataChangedDiagnosticEventNeedsRef: origin=ServiceNeeds_UseCase_Realization, destination-type=DIAGNOSTIC-EVENT-NEEDS
        container DemCallbackEventStatusChanged [0..*]  # The presence of this container indicates, that the Dem has access to an "EventStatusChanged" callback, which the Dem will call to notify other components about the change in the status of an event. | In case there is a DemCallbackEvenStatusChangedFnc, this parameter defines the name of the function that the Dem will call. In case there is no DemCallbackEvenStatusChangedFnc, the Dem will have an R-Port requiring the interface CallbackEventStatusChanged, whose name is generated by using the unique callback-prefix followed by the event name.
          function name DemCallbackEventStatusChangedFnc [0..1]: set at pre-compile  # Function name of prototype "EventStatusChanged"
          choice container DemCallbackEventStatusChangedBackRef [0..1]
            container DemCallbackEventStatusChangedSWC [0..1]
              instance reference DemCallbackEventStatusChangedSwcInternalBehaviorRef: origin=ServiceNeeds_UseCase_Realization, destination-context=ROOT-SW-COMPOSITION-PROTOTYPE SW-COMPONENT-PROTOTYPE, destination-type=SWC-INTERNAL-BEHAVIOR
              foreign reference DemCallbackEventStatusChangedSwcServiceDependencyRef: origin=ServiceNeeds_UseCase_Realization, destination-type=SWC-SERVICE-DEPENDENCY
            container DemCallbackEventStatusChangedBSW [0..1]
              foreign reference DemCallbackEventStatusChangedDiagnosticEventNeedsRef: origin=ServiceNeeds_UseCase_Realization, destination-type=DIAGNOSTIC-EVENT-NEEDS
        container DemCallbackInitMForE [0..1]  # The presence of this container indicates, that the Dem has access to an "InitMonitorForEvent" callback, which the Dem will call to initialize a monitor. | In case the container has a DemCallbackInitMForEFnc, this parameter defines the name of the function that the Dem will call. In case there is no DemCallbackInitMForEFnc, the Dem will have an R-Port requiring the interface CallbackInitMonitorForEvent, whose name is generated by using the unique callback-prefix followed by the event name.
          function name DemCallbackInitMForEFnc [0..1]: set at pre-compile  # Function name of prototype "InitMonitorForEvent".
          reference PartitionRef [0..1]: destination=EcucPartition
          choice container DemCallbackInitMForEBackRef [0..1]
            container DemCallbackInitMForESWC [0..1]
              instance reference DemCallbackInitMForESwcInternalBehaviorRef: origin=ServiceNeeds_UseCase_Realization, destination-context=ROOT-SW-COMPOSITION-PROTOTYPE SW-COMPONENT-PROTOTYPE, destination-type=SWC-INTERNAL-BEHAVIOR
              foreign reference DemCallbackInitMForESwcServiceDependencyRef: origin=ServiceNeeds_UseCase_Realization, destination-type=SWC-SERVICE-DEPENDENCY
            container DemCallbackInitMForEBSW [0..1]
              foreign reference DemCallbackInitMForEDiagnosticEventNeedsRef: origin=ServiceNeeds_UseCase_Realization, destination-type=DIAGNOSTIC-EVENT-NEEDS
        container DemEventClass  # This container contains the configuaration (parameters) for EventClass
          boolean DemAgingAllowed: set at pre-compile  # Switch to allow aging/unlearning of the event or not. | true: aging allowed false: aging not allowed
          integer DemAgingCycleCounterThreshold [0..1]: 1..256, set at pre-compile  # Number ot aging cycles needed to unlearn/delete the event.
          boolean DemConsiderPtoStatus: set at pre-compile  # This parameter is TRUE, when the event is affected by the Dem PTO handling.
          enumeration DemEventDestination [0..4]: {DEM_DTC_ORIGIN_MIRROR_MEMORY, DEM_DTC_ORIGIN_PRIMARY_MEMORY, DEM_DTC_ORIGIN_SECONDARY_MEMORY}, set at pre-compile  # The event destination assigns events to none, one or multiple origins. | If no event destination is assigned to a specific event, the event is handled internally and is not visible externally to the Dcm. If more than one event destination is assigned to a specific event, the event can be present in the corresponding origins.
          integer DemEventFailureCycleCounterThreshold [0..1]: 1..256, set at pre-compile  # Defines the number of failure cycles for the event based fault confirmation.
          enumeration DemEventOBDReadinessGroup: {DEM_OBD_RDY_AC, DEM_OBD_RDY_BOOSTPR, DEM_OBD_RDY_CAT, DEM_OBD_RDY_CMPRCMPT, DEM_OBD_RDY_EGSENS, DEM_OBD_RDY_ERG, DEM_OBD_RDY_EVAP, DEM_OBD_RDY_FLSYS, DEM_OBD_RDY_HCCAT, DEM_OBD_RDY_HTCAT, DEM_OBD_RDY_MISF, DEM_OBD_RDY_NONE, DEM_OBD_RDY_NOXCAT, DEM_OBD_RDY_O2SENS, DEM_OBD_RDY_O2SENSHT, DEM_OBD_RDY_PMFLT, DEM_OBD_RDY_SECAIR, DEM_OBD_RDY_FLSYS_NONCONT, DEM_OBD_RDY_PRIVATE, DEM_OBD_RDY_SECAIR_CMPL, DEM_OBD_RDY_BOOSTPR_CMPL, DEM_OBD_RDY_CAT_CMPL, DEM_OBD_RDY_CMPRCMPT_CMPL, DEM_OBD_RDY_ERG_CMPL, DEM_OBD_RDY_EGSENS_CMPL, DEM_OBD_RDY_EVAP_CMPL, DEM_OBD_RDY_FLSYS_CMPL, DEM_OBD_RDY_HTCAT_CMPL, DEM_OBD_RDY_HCCAT_CMPL, DEM_OBD_RDY_O2SENSHT_CMPL, DEM_OBD_RDY_MISF_CMPL, DEM_OBD_RDY_NOXCAT_CMPL, DEM_OBD_RDY_O2SENS_CMPL, DEM_OBD_RDY_PMFLT_CMPL, DEM_OBD_RDY_PRIVATE_CMPL}, set at pre-compile  # This parameter specifies the Event OBD Readiness group for PID $01 and PID $41 computation. | This parameter is only applicable for emission-related ECUs.
          integer DemEventPriority: 1..256, set at pre-compile  # Priority of the event, in view of full event buffer.
          enumeration DemEventSignificance [0..1]: {DEM_EVENT_SIGNIFICANCE_FAULT, DEM_EVENT_SIGNIFICANCE_OCCURRENCE}, set at pre-compile  # Significance of the event, which indicates additional information concerning fault classification and resolution. | It can be mapped as Dem-internal data element. It shall be configured, if it is a part of event related data.
          boolean DemFFPrestorageSupported: set at pre-compile  # If this parameter is set to true, then the Prestorage of FreezeFrames is supported by the assigned event. This parameter is useful to calculate the buffer size.
          choice reference DemAgingCycleRef [0..1]: set at pre-compile, origin=AUTOSAR_ECUC V1.0.0, destination=[DemGeneral/DemAgingCycle, DemGeneral/DemOperationCycle]  # Reference to the cycle which is triggering the aging of the event. This can either be the same as the operation cycle of the event, or a separate aging cycle reported via API Dem_SetAgingCycleState. If external aging is configured (refer to DemAgingCycleCounterProcessing), this parameter is not used.
          reference DemEnableConditionGroupRef [0..1]: set at pre-compile, origin=AUTOSAR_ECUC V1.0.0, destination=DemGeneral/DemEnableConditionGroup  # References an enable condition group.
          reference DemEventFailureCycleRef [0..1]: set at pre-compile, origin=AUTOSAR_ECUC V1.0.0, destination=DemGeneral/DemOperationCycle  # Kind of failure cycle for the event based fault confirmation.
          reference DemOperationCycleRef: set at pre-compile, origin=AUTOSAR_ECUC V1.0.0, destination=DemGeneral/DemOperationCycle  # Kind of operation cycle for the event (e.g. power cycle, driving cycle, ...)
          reference DemStorageConditionGroupRef [0..1]: set at pre-compile, origin=AUTOSAR_ECUC V1.0.0, destination=DemGeneral/DemStorageConditionGroup  # References a storage condition group.
          choice container DemDebounceAlgorithmClass  # Debounce algorithm class: counter based, time based, or monitor internal.
            container DemDebounceCounterBased [0..1]  # This container contains the configuration (parameters) for counter based debouncing.
              integer DemDebounceCounterDecrementStepSize: 0..32768, set at pre-compile  # Defines the step size for decrementation of the internal fault detection counter (PREPASSED).
              integer DemDebounceCounterFailedThreshold: 0..32767, set at pre-compile  # Defines the value of the internal fault detection counter, which indicates the failed status.
              integer DemDebounceCounterIncrementStepSize: 0..32767, set at pre-compile  # Defines the step size for incrementation of the internal fault detection counter (PREFAILED).
              boolean DemDebounceCounterJumpDown: set at pre-compile  # Switch for the activation of Jump-Down. | true: Jump-Down activated false: Jump-Down deactivated
              integer DemDebounceCounterJumpDownValue: -32768..32767, set at pre-compile  # Jump-Down value of the internal fault detection counter.
              boolean DemDebounceCounterJumpUp: set at pre-compile  # Switch for the activation of Jump-Up. | true: Jump-Up activated false: Jump-Up deactivated
              integer DemDebounceCounterJumpUpValue: -32768..32767, set at pre-compile  # Jump-Up value of the internal fault detection counter.
              integer DemDebounceCounterPassedThreshold: -32768..0, set at pre-compile  # Defines the value of the internal fault detection counter, which indicates the passed status.
            container DemDebounceMonitorInternal [0..1]  # This container contains the configuration (parameters) for monitor internal debouncing.
              container DemCallbackGetFDC [0..1]  # The presence of this container indicates, that the Dem has access to a "GetFaultDetectionCounter" callback, which the Dem will call to obtain the value of the fault detection counter. | In case the container has a DemCallbackGetFDCFnc, this parameter defines the name of the function that the Dem will call. In case there is no DemCallbackGetFDCFnc, the Dem will have a R-Port requiring the interface CallbackGetFaultDetectionCounter, whose name is generated by using the unique callback-prefix followed by the event name.
                function name DemCallbackGetFDCFnc [0..1]: set at pre-compile  # Function name of prototype "GetFaultDetectionCounter".
                choice container DemCallbackGetFDCBackRef [0..1]
                  container DemCallbackGetFDCSWC [0..1]
                    instance reference DemCallbackGetFDCSwcInternalBehaviorRef: origin=ServiceNeeds_UseCase_Realization, destination-context=ROOT-SW-COMPOSITION-PROTOTYPE SW-COMPONENT-PROTOTYPE, destination-type=SWC-INTERNAL-BEHAVIOR
                    foreign reference DemCallbackGetFDCSwcServiceDependencyRef: origin=ServiceNeeds_UseCase_Realization, destination-type=SWC-SERVICE-DEPENDENCY
            container DemDebounceTimeBase [0..1]  # This container contains the configuration (parameters) for time based debouncing.
              float DemDebounceTimeFailedThreshold: 0..3600, set at pre-compile  # Defines the time out duration for "Event Failed" qualification. | The AUTOSAR configuration standard is to use SI units, so this parameter is defined as float value in seconds. Dem configuration tools must convert this float value to the appropriate value format for the use in the software implementation of Dem.
              float DemDebounceTimePassedThreshold: 0..3600, set at pre-compile  # Defines the time out duration for "Event Passed" qualification. | The AUTOSAR configuration standard is to use SI units, so this parameter is defined as float value in seconds. Dem configuration tools must convert this float value to the appropriate value format for the use in the software implementation of Dem.
              float DemTimeBasedFdcThresholdStorageValue [0..1]: 0.0..3600.0  # Threshold to allocate an event memory entry and to capture the Freeze Frame.
            container DemDebounceLegacyS8
              integer AbcInc [0..1]: 0..127, default-value=1
              integer AbcDec [0..1]: 0..127, default-value=1
              integer AbcMax [0..1]: 1..127, default-value=1
            container DemDebounceLegacyS16
              integer AbcInc [0..1]: 0..32767, default-value=1
              integer AbcDec [0..1]: 0..32767, default-value=1
              integer AbcMax [0..1]: 1..32767, default-value=1
            container DemDebounceLegacyStc
            container DemDebounceLegacyCalClas
            container DemDebounceLegacyConfClas
            container DemDebounceLegacyMpl
            container DemDebounceLegacyIncDec
              integer inc [0..1]: ..65535
            container DemDebounceLegacyS15Min
              integer AbcInc [0..1]: 0..16383, default-value=1
              integer AbcDec [0..1]: 0..16383, default-value=1
              integer AbcMax [0..1]: 1..16383, default-value=1
              integer AbcMin [0..1]: -32768..0
          container DemDebounceInitBehavior
            boolean DemErrorResetAtEcuReset [0..1]
            boolean DemErrorResetAtKeyOn [0..1]
            boolean DemErrorLatchedOnFailure [0..1]
            boolean DemDebounceMaxMinusIncAfterFailure [0..1]
            boolean DemDebounceAbcNotResetAtNewDc [0..1]
            boolean DemDebounceAbcInitAtConditionLoss [0..1]
          container DemIndicatorAttribute [0..255]  # This container contains the event specific configuration of Indicators.
            enumeration DemIndicatorBehaviour: {DEM_INDICATOR_BLINKING, DEM_INDICATOR_BLINK_CONT, DEM_INDICATOR_CONTINUOUS}, set at post-build in variant post-build / pre-compile in variant pre-compile  # Behaviour of the linked indicator
            integer DemIndicatorFailureCycleCounterThreshold [0..1]: 0..255, set at pre-compile  # Defines the number of failure cycles for the WarningIndicatorOnCriteria.
            enumeration DemIndicatorFailureCycleSource: {DEM_FAILURE_CYCLE_EVENT, DEM_FAILURE_CYCLE_INDICATOR}, set at pre-compile  # This parameter defines, which failure cycle is used for the WarningIndicatorOnCriteria handling.
            integer DemIndicatorHealingCycleCounterThreshold: 0..255, set at pre-compile  # Defines the number of healing cycles for the WarningIndicatorOffCriteria.
            reference DemIndicatorFailureCycleRef [0..1]: set at pre-compile, destination=DemGeneral/DemOperationCycle  # Kind of failure cycle for the indicator controlled by the according event used for the WarningIndicatorOnCriteria.
            reference DemIndicatorHealingCycleRef: set at pre-compile, destination=DemGeneral/DemOperationCycle  # Kind of healing cycle for the indicator controlled by the according event used for the WarningIndicatorOffCriteria.
            reference DemIndicatorRef: set at pre-compile, destination=DemGeneral/DemIndicator  # Reference to the used indicator.
        choice container DemEventBackRef [0..1]
          container DemEventSWC [0..1]
            instance reference DemEventParameterSwcInternalBehaviorRef: origin=ServiceNeeds_UseCase_Realization, destination-context=ROOT-SW-COMPOSITION-PROTOTYPE SW-COMPONENT-PROTOTYPE, destination-type=SWC-INTERNAL-BEHAVIOR
            foreign reference DemEventParameterSwcServiceDependencyRef: origin=ServiceNeeds_UseCase_Realization, destination-type=SWC-SERVICE-DEPENDENCY
          container DemEventBSW [0..1]
            foreign reference DemEventParameterDiagnosticEventNeedsRef: origin=ServiceNeeds_UseCase_Realization, destination-type=DIAGNOSTIC-EVENT-NEEDS
      container DemPidClass [0..255]  # This container contains the different PIDs for the single global OBD relevant freeze frame class. It is assembled out of one or several data elements.
        integer DemPidIdentifier: 0..255, set at post-build in variant post-build / pre-compile in variant pre-compile  # identifier of the PID
        integer DemPidSize: 0..255  # Size of the complete PID - including all data elements for this PID
        container DemPidDataElement [1..255]  # This container contains the different data elements contained in the specific PID.
          integer Index: 0..255  # Defines the index where the Pid Data element is located within the configured PidClass
          integer PidDataPos: 0..255  # This index defines the position of the Pid data element given by ISO
          string DcnfxmlFileSource [0..1]
          choice reference DemPidDataElementClassRef: set at post-build in variant post-build / pre-compile in variant pre-compile, destination=[DemDataElementClass/DemExternalCSDataElementClass, DemDataElementClass/DemExternalSRDataElementClass, DemDataElementClass/DemInternalDataElementClass, DemExternalDADataElementClass, DemExternalFADataElementClass]  # This reference contains the link to a data element class.
      container DemErrm4xxFailures [0..1]
        container DemErrm4xxFailure [0..*]
          string DemErrm4FailureCallback: with-auto=true
          multiline string DemErrm4FailureDescription [0..1]
          multiline string DemErrm4FailureSource [0..1]
          enumeration DemErrm4FailureIdentifierStyle [0..1]: {SCALAR_XX_ERR_IDX, SCALAR_NC_IDX_DIAG, ARRAY_CONST_NC_IDX_DIAG, ARRAY_MEMO29_NC_IDX_DIAG}, default-value=COMPLIANT
          enumeration DemErrm4OutputCfg [0..1]: {OLD, NONE, ALL, ERR_END_CDN_SYM, ERR_END_CDN, ERR_END_SYM, ERR_END, ERR_CDN_SYM, ERR_CDN, ERR_SYM, ERR, END_CDN_SYM, END_CDN, END_SYM, END, CDN_SYM, CDN, SYM}
          boolean DemErrmArrayAccessSuppressed [0..1]
          string DemErrm4FailureHierarchyName [0..1]
          string DemErrm4FailureDisplayName [0..1]  # May contain an element specific more human-readable name to substitute the shortname
          string DemErrm4FailureModuleName [0..1]
          string DemErrm4FailurePureFunctionName [0..1]
          string DcnfxmlFileSource [0..1]
          container DemErrm4xxSymptom [1..4]
            integer DemErrm4SymptomNumber
            string DcnfxmlFileSource [0..1]
            reference DemErrm4xxSymptomDemEventParameterRef: destination=DemConfigSet/DemEventParameter
      container DemDtrs [0..1]
        container DemDtr [0..65535]  # This container holds the configuration of the individual DTRs.
          float DemDtrCompuDenominator0: set at pre-compile  # Part of the conversion between the binary representation and the physical meaning analogous to the SW-C Template conversion CompuRationalCoeffs with 2 numerator coefficients and 1 denominator coefficient in the direction compuInternalToPhys. | This is the only one supported denominator value, a constant divisor. The value 0 is not allowed.
          float DemDtrCompuNumerator0: set at pre-compile  # Part of the conversion between the binary representation and the physical meaning analogous to the SW-C Template conversion CompuRationalCoeffs with 2 numerator coefficients and 1 denominator coefficient in the direction compuInternalToPhys. | This is the first numerator value, which is multiplied with x^0, i.e., the offset.
          string DemDtrDescription [0..1]
          float DemDtrCompuNumerator1: set at pre-compile  # Part of the conversion between the binary representation and the physical meaning analogous to the SW-C Template conversion CompuRationalCoeffs with 2 numerator coefficients and 1 denominator coefficient in the direction compuInternalToPhys. | This is the second numerator value, which is multiplied with x^1, i.e., the factor.
          string DemDtrHierarchyName [0..1]
          integer DemDtrId: 0..65535, set at pre-compile, symbolic-name-value=true  # The index identifier value assigned to this DTR. The value is generated during the Dem configuration process.
          integer DemDtrMid: 0..255, set at post-build in variant post-build / pre-compile in variant pre-compile  # The OBDMID of the DTR. | The values 0x00, 0x20, 0x40, 0x60, 0x80, 0xA0, 0xC0, 0xE0 are reserved.
          string DemDtrSource [0..*]
          integer DemDtrTid: 0..255, set at post-build in variant post-build / pre-compile in variant pre-compile  # The OBDTID of the DTR.
          integer DemDtrUasid: 0..255, set at post-build in variant post-build / pre-compile in variant pre-compile  # The UaSId the DTR data shall be scaled to, and reported together with the rescaled DTR data.
          enumeration DemDtrUpdateKind [0..1]: {DEM_DTR_UPDATE_ALWAYS, DEM_DTR_UPDATE_STEADY, DEM_DTR_UPDATE_READY}, set at pre-compile  # Update conditions applied by the Dem to reports of DTR values. Only supported if a related Event is configured. If no related Event is configured, the Dem behaves as if DemDtrUpdateKind is configured to "DEM_DTR_UPDATE_ALWAYS".
          boolean DemDtrArrayAccessSuppressed [0..1]
          string DemDtrDisplayName [0..1]  # May contain an element specific more human-readable name to substitute the shortname
          string DemDtrModuleName [0..1]
          string DemDtrPureFunctionName [0..1]
          string DcnfxmlFileSource [0..1]
          reference DemDtrEventRef [0..1]: set at pre-compile, destination=DemConfigSet/DemEventParameter  # Reference to the DemEventParameter this DTR is related to. If the related event is not configured, the Dem cannot ensure consistency between the DTR and the event.
          foreign reference ApplicationDataTypeRef [0..1]: destination-type=APPLICATION-DATA-TYPE
    container DemGeneral  # This container contains the configuration (parameters) of the BSW Dem
      enumeration DemAgingCycleCounterProcessing: {DEM_PROCESS_AGINGCTR_EXTERN, DEM_PROCESS_AGINGCTR_INTERN}, set at pre-compile  # This configuration switch defines, whether the aging counter is calculated Dem-internally or provided via Dem_SetAgingCycleCounterValue.
      integer DemBswErrorBufferSize: 0..255, set at pre-compile  # Maximum number of elements in buffer for handling of BSW errors (ref. to Dem107).
      enumeration DemClearDTCBehavior: {DEM_CLRRESP_NONVOLATILE_FINISH, DEM_CLRRESP_NONVOLATILE_TRIGGER, DEM_CLRRESP_VOLATILE}, set at pre-compile  # Defines the clearing process of diagnostic information for volatile and non-volatile memory and the positive response handling for the Dcm module.
      boolean DemDTCSuppressionSupport: set at pre-compile  # This configuration switch defines, whether support for DTC suppression is enabled or not. | true: DTC suppression support is enabled false: DTC suppression support is disabled
      boolean DemDebounceCounterBasedSupport: set at pre-compile  # This configuration switch defines, whether support for counter based debouncing is enabled or not. | true: counter based debouncing support is enabled false: counter based debouncing support is disabled
      boolean DemDebounceTimeBasedSupport: set at pre-compile  # This configuration switch defines, whether support for time based debouncing is enabled or not. | true: time based debouncing support is enabled false: time based debouncing support is disabled
      boolean DemDevErrorDetect: set at pre-compile  # Activate/Deactivate the Development Error Detection and Notification. | true: Development Error Detection and Notification activated false: Development Error Detection and Notification deactivated
      integer DemDtcStatusAvailabilityMask: 0..255, set at pre-compile  # Mask for the supported DTC status bits by the Dem. This mask is used by UDS service 0x19.
      boolean DemEnableConditionSupport: set at pre-compile  # This configuration switch defines, whether support for enable conditions is enabled or not. | true: support for enable conditions is enabled false: support for enable conditions is disabled
      enumeration DemEventCombinationSupport: {DEM_EVCOMB_DISABLED, DEM_EVCOMB_TYPE1, DEM_EVCOMB_TYPE2}, set at pre-compile  # This parameter defines the type of event combination supported by the Dem.
      boolean DemEventDisplacementSupport: set at pre-compile  # This configuration switch defines, whether support for event displacement is enabled or not. | true: event displacement support is enabled false: event displacement support is disabled
      enumeration DemExtendedDataCapture [0..1]: {DEM_TRIGGER_EVENT_MEMORY_STORAGE, DEM_TRIGGER_TESTFAILED}, set at pre-compile  # This parameter defines the point in time, when the extended data collection is done for the initial event memory entry.
      enumeration DemFreezeFrameCapture [0..1]: {DEM_TRIGGER_EVENT_MEMORY_STORAGE, DEM_TRIGGER_TESTFAILED}, set at pre-compile  # This parameter defines the point in time, when the freeze frame data collection is done for the initial event memory entry.
      string DemHeaderFileInclusion [0..*]: set at pre-compile, regular-expression=[a-zA-Z0-9_]([a-zA-Z0-9\._])*  # Name of the header file(s) to be included by the Dem module containing the used C-callback declarations.
      integer DemImmediateNvStorageLimit [0..1]: 1..255, set at pre-compile  # This parameter defines the maximum number of occurrences, a specific event memory entry is allowed, to be stored in NVRAM immediately (refer to DemImmediateNvStorage).
      integer DemMaxNumberEventEntryMirror: 0..255, set at pre-compile  # Maximum number of events which can be stored in the mirror memory
      integer DemMaxNumberEventEntryPermanent: 0..255, set at pre-compile  # Maximum number of events which can be stored in the permanent memory. | The assignment of an event to this memory type is dynamic and used for emission-related events only.
      integer DemMaxNumberEventEntryPrimary: 1..255, set at pre-compile  # Maximum number of events which can be stored in the primary memory
      integer DemMaxNumberEventEntrySecondary: 0..255, set at pre-compile  # Maximum number of events which can be stored in the secondary memory
      integer DemMaxNumberPrestoredFF: 0..255, set at pre-compile  # Defines the maximum number for prestored freeze frames. | If set to 0, then freeze frame prestorage is not supported by the ECU.
      boolean DemOBDSupport: set at pre-compile  # This configuration switch defines whether OBD is supported or not
      enumeration DemOccurrenceCounterProcessing: {DEM_PROCESS_OCCCTR_CDTC, DEM_PROCESS_OCCCTR_TF}, set at pre-compile  # This configuration switch defines the consideration of the fault confirmation process for the occurrence counter. For OBD and mixed systems (OBD/non OBD, refer to DemOBDSupport) the fault confirmation process must not be considered.
      enumeration DemOperationCycleProcessing: {DEM_PROCESS_OPCYC_COUNTER, DEM_PROCESS_OPCYC_STATE}, set at pre-compile  # This configuration switch defines, whether the operation cycles are triggered by DEM_CYCLE_STATE_START or collecting an external counter value, which results in respective state changes.
      boolean DemOperationCycleStatusStorage: set at pre-compile  # Defines if the operation cycle state is available over the power cycle (stored non-volatile) or not. | true: the operation cycle state is stored non-volatile false: the operation cycle state is only stored volatile
      boolean DemPTOSupport: set at pre-compile  # This configuration switch defines, whether PTO support (and therefore PID $1E support) is enabled or not.
      enumeration DemStatusBitHandlingTestFailedSinceLastClear: {DEM_STATUS_BIT_AGING_AND_DISPLACEMENT, DEM_STATUS_BIT_NORMAL}, set at pre-compile  # This configuration switch defines, whether the aging and displacement mechanism shall be applied to the "TestFailedSinceLastClear" status bits.
      boolean DemStatusBitStorageTestFailed: set at pre-compile  # Activate/Deactivate the permanent storage of the "TestFailed" status bits. | true: storage activated false: storage deactivated
      boolean DemStorageConditionSupport: set at pre-compile  # This configuration switch defines, whether support for storage conditions is enabled or not. | true: support for storage conditions is enabled false: support for storage conditions is disabled
      float DemTaskTime: 0..0.1, set at pre-compile, origin=AUTOSAR_ECUC V1.0.0  # Allow to configure the time for the periodic cyclic task. Please note: This configuration value shall be equal to the value in the Basic Software Scheduler configuration of the RTE module. | The AUTOSAR configuration standard is to use SI units, so this parameter is defined as float value in seconds. Dem configuration tools must convert this float value to the appropriate value format for the use in the software implementation of Dem. min: A negative value is not allowed. max: After event status was reported, processing shall be completed within 100ms in order to have the fault entry status information updated as soon as possible (e.g. for PID $01). upperMultiplicity: Exactly one TaskTime must be specified per configuration. lowerMultiplicity: Exactly one TaskTime must be specified per configuration.
      boolean DemTriggerDcmReports: set at pre-compile  # Activate/Deactivate the notification to the Diagnostic Communication Manager for ROE processing. | true: Dcm ROE notification activated false: Dcm ROE notification deactivated
      boolean DemTriggerDltReports: set at pre-compile  # Activate/Deactivate the notification to the Diagnostic Log and Trace. | true: Dlt notification activated false: Dlt notification deactivated
      boolean DemTriggerFiMReports: set at pre-compile  # Activate/Deactivate the notification to the Funciton Inhibition Manager. | true: FiM notification activated false: FiM notification deactivated
      boolean DemTriggerMonitorInitBeforeClearOk: set at pre-compile  # Defines if the monitor re-initialization has to be triggered before or after the Dem module returns DEM_CLEAR_OK. | true: trigger re-initialization before DEM_CLEAR_OK false: trigger re-initialization after DEM_CLEAR_OK
      enumeration DemTypeOfDTCSupported: {DEM_DTC_TRANSLATION_ISO11992_4, DEM_DTC_TRANSLATION_ISO14229_1, DEM_DTC_TRANSLATION_ISO15031_6, DEM_DTC_TRANSLATION_SAEJ1939_73}, set at pre-compile  # This parameter defines the format returned by Dem_GetTranslationType and does not relate to/influence the supported Dem functionality.
      enumeration DemTypeOfFreezeFrameRecordNumeration: {DEM_FF_RECNUM_CALCULATED, DEM_FF_RECNUM_CONFIGURED}, set at pre-compile  # This parameter defines the type of assigning freeze frame record numbers for event-specific freeze frame records.
      boolean DemVersionInfoApi: set at pre-compile  # Activate/Deactivate the version information API. | true: version information activated false: version information deactivated
      string DemErrmHeaderFileInclusion [0..*]: set at pre-compile, regular-expression=[a-zA-Z0-9_]([a-zA-Z0-9\._])*  # Name of the header file(s) to be included by the ERRM adaptation containing the used C-callback declarations.
      string DemFrfHeaderFileInclusion [0..*]: set at pre-compile, regular-expression=[a-zA-Z0-9_]([a-zA-Z0-9\._])*  # Name of the header file(s) to be included by the FRF configuration
      reference DemMILIndicatorRef [0..1]: set at pre-compile, destination=DemGeneral/DemIndicator  # This parameter defines the indicator representing the MIL. | This paramteter is mandatory for ECUs supporting OBD (refer to DemOBDSupport).
      container DemAgingCycle [0..256]  # Note that this container definition does not explicitly define a symbolic name parameter. Instead, the short name of the container will be used in the Ecu Configuration Description to specify the symbolic name of the aging cycle name. These aging cycles are reported via API Dem_SetAgingCycleState only.
      container DemCallbackDTCStatusChanged [0..*]  # The presence of this container indicates, that the Dem has access to a "DTCStatusChanged" callback, which the Dem will call to notify other components about the change in the status of a DTC. | In case there is a DemCallbackDTCStatusChangedFnc, this parameter defines the name of the function that the Dem will call. In case there is no DemCallbackDTCStatusChangedFnc, the Dem will have an R-Port requiring the interface CallbackDTCStatusChanged whose name is generated by using the unique callback-prefix followed by the event name.
        function name DemCallbackDTCStatusChangedFnc [0..1]: set at pre-compile  # Function name of prototype "DTCStatusChanged". | Note: If the parameter DemTriggerDcmReports is enabled, this parameter shall not be "Dcm_DemTriggerOnDTCStatus".
        string DcnfxmlFileSource [0..1]
        choice container DemCallbackDTCStatusChangedBackRef [0..1]
          container DemCallbackDTCStatusChangedSWC [0..1]
            instance reference DemCallbackDTCStatusChangedSwcInternalBehaviorRef: origin=ServiceNeeds_UseCase_Realization, destination-context=ROOT-SW-COMPOSITION-PROTOTYPE SW-COMPONENT-PROTOTYPE, destination-type=SWC-INTERNAL-BEHAVIOR
            foreign reference DemCallbackDTCStatusChangedSwcServiceDependencyRef: origin=ServiceNeeds_UseCase_Realization, destination-type=SWC-SERVICE-DEPENDENCY
          container DemCallbackDTCStatusChangedBSW [0..1]
            foreign reference DemCallbackDTCStatusChangedDiagnosticEventNeedsRef: origin=ServiceNeeds_UseCase_Realization, destination-type=DIAGNOSTIC-EVENT-MANAGER-NEEDS
      choice container DemDataElementClass [0..255]  # This container contains the configuration (parameters) for an internal/external data element class.
        container DemExternalCSDataElementClass [0..1]  # This container contains the configuration (parameters) for an external client/server based data element class. | It defines, how the Dem can obtain the value of the data element from either a SW-C or another BSW module. Whether a client/server port or a C function-call is used, is defined by DemDataElementUsePort.
          string DataName
          string ConversionName [0..1]
          integer DemDataElementDataSize: 1..255, set at pre-compile  # Defines the size of the data element in bytes.
          function name DemDataElementReadFnc [0..1]: set at pre-compile  # In case of DemDataElementUsePort is false, this parameter defines the prototype of the C function "ReadDataElement" used to get the according value.
          boolean DemDataElementUsePort: set at pre-compile  # If the parameter is set to True, a R-Port is generated, to obtain the data element (interface DataServices_<SyncDataElement>). | If the parameter is set to False, the information is obtained by C function-call on another BSW module specified by the parameter DemDataElementReadFnc.
          integer DidIdentifier [0..1]: 0..65535  # Defines the Data identfier
          integer DemDidSize [0..1]: 0..255  # Defines the complete size of a multiple Did, including all data and additional information (size, padding values), but exluding the Did number itself.
          integer Index [0..1]: 0..255  # Defines the index where the Data element is located within a multiple Did
          multiline string IsPartOfFrfBlock [0..*]  # Defines the freeze frame block, where the data belongs to
          boolean DemDataElementTypeIsSigned  # Defines the signed or unsigned type
          boolean PrevData [0..1]  # Switch for data loading
          choice container DemExternalCSDataElementClassBackRef [0..1]
            container DemExternalCSDataElementClassSWC [0..1]
              instance reference DemExternalCSDataElementClassSwcInternalBehaviorRef: origin=ServiceNeeds_UseCase_Realization, destination-context=ROOT-SW-COMPOSITION-PROTOTYPE SW-COMPONENT-PROTOTYPE, destination-type=SWC-INTERNAL-BEHAVIOR
              foreign reference DemExternalCSDataElementClassSwcServiceDependencyRef: origin=ServiceNeeds_UseCase_Realization, destination-type=SWC-SERVICE-DEPENDENCY
            container DemExternalCSDataElementClassBSW [0..1]
              foreign reference DemExternalCSDataElementClassDiagnosticEventManagerNeedsRef: origin=ServiceNeeds_UseCase_Realization, destination-type=DIAGNOSTIC-EVENT-MANAGER-NEEDS
          container DemDataElementConversion [0..1]
            string DemDataElementConversionUnit [0..1]
            string DemDataElementConversionFormatString [0..1]
            float DemDataElementConversionM: set at pre-compile, default-value=1.0  # Part of the conversion between the binary representation and the physical meaning analogous to the SW-C Template conversion CompuRationalCoeffs with 2 numerator coefficients and 1 denominator coefficient in the direction compuInternalToPhys. | This is the only one supported denominator value, a constant divisor. The value 0 is not allowed.
            float DemDataElementConversionB: set at pre-compile, default-value=0.0  # Part of the conversion between the binary representation and the physical meaning analogous to the SW-C Template conversion CompuRationalCoeffs with 2 numerator coefficients and 1 denominator coefficient in the direction compuInternalToPhys. | This is the only one supported denominator value, a constant divisor. The value 0 is not allowed.
            integer DemDataElementConversionMinimum [0..1]: -2147483648..4294967295, default-value=0
            integer DemDataElementConversionMaximum [0..1]: -2147483648..4294967295, default-value=0
            multiline string DemDataElementStateConversionPhys [0..*]
            multiline string DemDataElementStateConversionHex [0..*]
        container DemExternalSRDataElementClass [0..1]  # This container contains the configuration (parameters) for an external sender/receiver based data element class. It defines, how the Dem can obtain the value of the data element from a SW-C, by using a sender/receiver port.
          string DataName
          string ConversionName [0..1]
          integer DemDataElementDataSize: 1..255, set at pre-compile  # Defines the size of the data element in bits.
          integer DidIdentifier [0..1]: 0..65535  # Defines the Data identfier
          integer DemDidSize [0..1]: 0..255  # Defines the complete size of a multiple Did, including all data and additional information (size, padding values), but exluding the Did number itself.
          integer Index [0..1]: 0..255  # Defines the index where the Data element is located within a multiple Did
          multiline string IsPartOfFrfBlock [0..*]  # Defines the freeze frame block, where the data belongs to
          boolean DemDataElementTypeIsSigned: default-value=false  # Defines the signed or unsigned type
          boolean PrevData [0..1]  # Switch for data loading
          instance reference DemDataElementInstanceRef: set at pre-compile, destination-context=ROOT-SW-COMPOSITION-PROTOTYP SW-COMPONENT-PROTOTYPE+ PORT-PROTOTYPE, destination-type=VARIABLE-DATA-PROTOTYPE  # Instance Reference to the actual OperationPrototype which shall be traced.
          container DemDataElementConversion [0..1]
            string DemDataElementConversionUnit [0..1]
            string DemDataElementConversionFormatString [0..1]
            float DemDataElementConversionM: set at pre-compile, default-value=1.0  # Part of the conversion between the binary representation and the physical meaning analogous to the SW-C Template conversion CompuRationalCoeffs with 2 numerator coefficients and 1 denominator coefficient in the direction compuInternalToPhys. | This is the only one supported denominator value, a constant divisor. The value 0 is not allowed.
            float DemDataElementConversionB: set at pre-compile, default-value=0.0  # Part of the conversion between the binary representation and the physical meaning analogous to the SW-C Template conversion CompuRationalCoeffs with 2 numerator coefficients and 1 denominator coefficient in the direction compuInternalToPhys. | This is the only one supported denominator value, a constant divisor. The value 0 is not allowed.
            integer DemDataElementConversionMinimum [0..1]: -2147483648..4294967295, default-value=0
            integer DemDataElementConversionMaximum [0..1]: -2147483648..4294967295, default-value=0
            multiline string DemDataElementStateConversionPhys [0..*]
            multiline string DemDataElementStateConversionHex [0..*]
        container DemInternalDataElementClass [0..1]  # This container contains the configuration (parameters) for an internal data element class.
          string DataName
          string ConversionName [0..1]
          integer DemDataElementDataSize: 1..255, set at pre-compile  # Defines the size of the data element in bytes.
          enumeration DemInternalDataElement: {DEM_AGINGCTR, DEM_OCCCTR, DEM_OVFLIND, DEM_SIGNIFICANCE}, set at pre-compile  # This parameter defines the Dem-internal data value, which is mapped to the data element.
          integer DidIdentifier [0..1]: 0..65535  # Defines the Data identfier
          integer DemDidSize [0..1]: 0..255  # Defines the complete size of a multiple Did, including all data and additional information (size, padding values), but exluding the Did number itself.
          integer Index [0..1]: 0..255  # Defines the index where the Data element is located within a multiple Did
          multiline string IsPartOfFrfBlock [0..*]  # Defines the freeze frame block, where the data belongs to
          boolean DemDataElementTypeIsSigned  # Defines the signed or unsigned type
          boolean PrevData [0..1]  # Switch for data loading
          container DemDataElementConversion [0..1]
            string DemDataElementConversionUnit [0..1]
            string DemDataElementConversionFormatString [0..1]
            float DemDataElementConversionM: set at pre-compile, default-value=1.0  # Part of the conversion between the binary representation and the physical meaning analogous to the SW-C Template conversion CompuRationalCoeffs with 2 numerator coefficients and 1 denominator coefficient in the direction compuInternalToPhys. | This is the only one supported denominator value, a constant divisor. The value 0 is not allowed.
            float DemDataElementConversionB: set at pre-compile, default-value=0.0  # Part of the conversion between the binary representation and the physical meaning analogous to the SW-C Template conversion CompuRationalCoeffs with 2 numerator coefficients and 1 denominator coefficient in the direction compuInternalToPhys. | This is the only one supported denominator value, a constant divisor. The value 0 is not allowed.
            integer DemDataElementConversionMinimum [0..1]: -2147483648..4294967295, default-value=0
            integer DemDataElementConversionMaximum [0..1]: -2147483648..4294967295, default-value=0
            multiline string DemDataElementStateConversionPhys [0..*]
            multiline string DemDataElementStateConversionHex [0..*]
        container DemExternalDADataElementClass [0..1]  # This container contains the configuration (parameters) for an direct adress access to an individual data element.
          string DataName
          string ConversionName [0..1]
          integer DemDataElementDataSize: 1..255, set at pre-compile  # Defines the size of the data element in bytes.
          integer DidIdentifier [0..1]: 0..65535  # Defines the Data identfier
          integer DemDidSize [0..1]: 0..255  # Defines the complete size of a multiple Did, including all data and additional information (size, padding values), but exluding the Did number itself.
          integer Index [0..1]: 0..255  # Defines the index where the Data element is located within a multiple Did
          multiline string IsPartOfFrfBlock [0..*]  # Defines the freeze frame block, where the data belongs to
          boolean DemDataElementTypeIsSigned  # Defines the signed or unsigned type
          boolean PrevData [0..1]  # Switch for data loading
          container DemDataElementConversion [0..1]
            string DemDataElementConversionUnit [0..1]
            string DemDataElementConversionFormatString [0..1]
            float DemDataElementConversionM: set at pre-compile, default-value=1.0  # Part of the conversion between the binary representation and the physical meaning analogous to the SW-C Template conversion CompuRationalCoeffs with 2 numerator coefficients and 1 denominator coefficient in the direction compuInternalToPhys. | This is the only one supported denominator value, a constant divisor. The value 0 is not allowed.
            float DemDataElementConversionB: set at pre-compile, default-value=0.0  # Part of the conversion between the binary representation and the physical meaning analogous to the SW-C Template conversion CompuRationalCoeffs with 2 numerator coefficients and 1 denominator coefficient in the direction compuInternalToPhys. | This is the only one supported denominator value, a constant divisor. The value 0 is not allowed.
            integer DemDataElementConversionMinimum [0..1]: -2147483648..4294967295, default-value=0
            integer DemDataElementConversionMaximum [0..1]: -2147483648..4294967295, default-value=0
            multiline string DemDataElementStateConversionPhys [0..*]
            multiline string DemDataElementStateConversionHex [0..*]
        container DemExternalFADataElementClass [0..1]  # This container contains the configuration (parameters) to retrieve data by calling a function. | It defines, how the Dem can obtain the value of the data element from a function call of uint8/sint8/uint16/sint16/uint32/sint32 function(void) type.
          string DataName
          string ConversionName [0..1]
          integer DemDataElementDataSize: 1..255, set at pre-compile  # Defines the size of the data element in bytes.
          function name DemDataElementReadFnc [0..1]: set at pre-compile  # This parameter defines the prototype of the C function "ReadDataElement" used to get the according value.
          integer DidIdentifier [0..1]: 0..65535  # Defines the Data identfier
          integer DemDidSize [0..1]: 0..255  # Defines the complete size of a multiple Did, including all data and additional information (size, padding values), but exluding the Did number itself.
          integer Index [0..1]: 0..255  # Defines the index where the Data element is located within a multiple Did
          multiline string IsPartOfFrfBlock [0..*]  # Defines the freeze frame block, where the data belongs to
          boolean DemDataElementTypeIsSigned  # Defines the signed or unsigned type
          boolean PrevData [0..1]  # Switch for data loading
          container DemDataElementConversion [0..1]
            string DemDataElementConversionUnit [0..1]
            string DemDataElementConversionFormatString [0..1]
            float DemDataElementConversionM: set at pre-compile, default-value=1.0  # Part of the conversion between the binary representation and the physical meaning analogous to the SW-C Template conversion CompuRationalCoeffs with 2 numerator coefficients and 1 denominator coefficient in the direction compuInternalToPhys. | This is the only one supported denominator value, a constant divisor. The value 0 is not allowed.
            float DemDataElementConversionB: set at pre-compile, default-value=0.0  # Part of the conversion between the binary representation and the physical meaning analogous to the SW-C Template conversion CompuRationalCoeffs with 2 numerator coefficients and 1 denominator coefficient in the direction compuInternalToPhys. | This is the only one supported denominator value, a constant divisor. The value 0 is not allowed.
            integer DemDataElementConversionMinimum [0..1]: -2147483648..4294967295, default-value=0
            integer DemDataElementConversionMaximum [0..1]: -2147483648..4294967295, default-value=0
            multiline string DemDataElementStateConversionPhys [0..*]
            multiline string DemDataElementStateConversionHex [0..*]
      container DemDidClass [0..255]  # This container contains the configuration (parameters) for a data Id class. It is assembled out of one or several data elements.
        integer DemDidIdentifier: 0..65535, set at pre-compile  # Identifier of the Data ID.
        choice reference DemDidDataElementClassRef [1..255]: set at pre-compile, destination=[DemDataElementClass/DemExternalCSDataElementClass, DemDataElementClass/DemExternalSRDataElementClass, DemDataElementClass/DemInternalDataElementClass, DemExternalFADataElementClass]  # This reference contains the link to a data element class.
      container DemEnableCondition [0..255]  # This container contains the configuration (parameters) for enable conditions.
        integer DemEnableConditionId: 0..255, set at pre-compile, symbolic-name-value=true  # Defines a unique enable condition Id. | This parameter should not be changeable by user, because the Id should be generated by Dem itself to prevent gaps and multiple use of an Id. The enable conditions should be sequentially ordered beginning with 0 and no gaps in between.
        boolean DemEnableConditionStatus: set at pre-compile  # Defines the inital status for enable or disable of acceptance of event reports of a diagnostic event. | The value is the initialization after power up (before this condition is reported the first time). true: acceptance of a diagnostic event enabled false: acceptance of a diagnostic event disabled
        string DemEnableConditionDescription [0..1]
        string DemEnableConditionSource [0..*]
        string DemEnableConditionHierarchyName [0..1]
        string DemEnableConditionDisplayName [0..1]
        string DemEnableConditionModuleName [0..1]
        string DemEnableConditionPureFunctionName [0..1]
        string DcnfxmlFileSource [0..*]
        boolean DisablesPid0x41 [0..1]: default-value=false  # If set to TRUE, an inhibition through this EnableCondition will set the PID 0x41 enable status to disabled for the group that the inhibited Events belong to. Typicall set to TRUE for EnableConditions like "not high altitude", and typically set to FALSE for "key on".
        reference DemEnableConditionControlDtcSettingDemClientRef [0..1]: destination=DemClient  # Reference to a DemClient that drives this EnableCondition through the ControlDtcSetting (Service 0x85) interfaces (Dem_Enable/DisableDTCSetting)
        choice container DemEnableConditionBackRef [0..1]
          container DemEnableConditionSWC [0..1]
            instance reference DemEnableConditionSwcInternalBehaviorRef: origin=ServiceNeeds_UseCase_Realization, destination-context=ROOT-SW-COMPOSITION-PROTOTYPE SW-COMPONENT-PROTOTYPE, destination-type=SWC-INTERNAL-BEHAVIOR
            foreign reference DemEnableConditionSwcServiceDependencyRef: origin=ServiceNeeds_UseCase_Realization, destination-type=SWC-SERVICE-DEPENDENCY
      container DemEnableConditionGroup [0..255]  # This container contains the configuration (parameters) for enable condition groups.
        reference DemEnableConditionRef [1..255]: set at pre-compile, origin=AUTOSAR_ECUC V1.0.0, destination=DemGeneral/DemEnableCondition  # References an enable condition.
      container DemExtendedDataClass [0..*]  # This class contains the combinations of extended data records for an extended data class.
        string DcnfxmlFileSource [0..1]
        reference DemExtendedDataRecordClassRef [1..253]: set at pre-compile, destination=DemGeneral/DemExtendedDataRecordClass  # This reference contains the link to an extended data class record.
      container DemExtendedDataRecordClass [0..253]  # This container contains the configuration (parameters) for an extended data record class. | It is assembled out of one or several data elements.
        integer DemExtendedDataRecordNumber: 0..253, set at pre-compile  # This configuration parameter specifies an unique identifier for an extended data record. | One or more extended data records can be assigned to one diagnostic event/DTC. 0xFF and 0xFE are resereved by ISO (therefore the maximal value equals 253).
        enumeration DemExtendedDataRecordUpdate [0..1]: {DEM_UPDATE_RECORD_NO, DEM_UPDATE_RECORD_YES}, set at pre-compile  # This parameter defines the case, when the extended data record is stored/updated.
        string DcnfxmlFileSource [0..1]
        choice reference DemDataElementClassRef [1..255]: set at pre-compile, destination=[DemDataElementClass/DemExternalCSDataElementClass, DemDataElementClass/DemExternalSRDataElementClass, DemDataElementClass/DemInternalDataElementClass, DemExternalFADataElementClass]  # This reference contains the link to a data element class.
      container DemFreezeFrameClass [0..255]  # This container contains the combinations of DIDs for a non OBD relevant freeze frame class.
        reference DemDidClassRef [1..255]: set at pre-compile, destination=DemGeneral/DemDidClass  # For OBD relevant data | Multiple PIDs can be relevant per freeze frame.
      container DemFreezeFrameRecNumClass [0..255]  # This container contains a list of dedicated, different freeze frame record numbers assigned to an event. The order of record numbers in this list is assigned to the chronological order of the according freeze frame records. | dependency: DemTypeOfFreezeFrameRecordNumeration
        integer DemFreezeFrameRecordNumber [1..254]: 1..254, set at pre-compile  # This parameter defines a record number for a freeze frame record. This record number is unique per freeze frame record number class. | The range of this value is defined by ISO 14229-1 (0x01 .. 0xFE).
      container DemGeneralOBD [0..1]  # This container contains the general OBD-specific configuration (parameters) of the Dem module.
        choice reference DemOBDInputAcceleratorPaddleInformation: set at pre-compile, destination=[DemDataElementClass/DemExternalCSDataElementClass, DemDataElementClass/DemExternalSRDataElementClass]  # Input variable for the accelerator paddle information, which is assigned to a specific data element used as interface for the Dem-internal PID calculations.
        choice reference DemOBDInputAmbientPressure: set at pre-compile, destination=[DemDataElementClass/DemExternalCSDataElementClass, DemDataElementClass/DemExternalSRDataElementClass]  # Input variable for the ambient pressure, which is assigned to a specific data element used as interface for the Dem-internal PID calculations.
        choice reference DemOBDInputAmbientTemperature: set at pre-compile, destination=[DemDataElementClass/DemExternalCSDataElementClass, DemDataElementClass/DemExternalSRDataElementClass]  # Input variable for the ambient temperature, which is assigned to a specific data element used as interface for the Dem-internal PID calculations.
        choice reference DemOBDInputDistanceInformation: set at pre-compile, destination=[DemDataElementClass/DemExternalCSDataElementClass, DemDataElementClass/DemExternalSRDataElementClass]  # Input variable for the distance information, which is assigned to a specific data element used as interface for the Dem-internal PID calculations.
        choice reference DemOBDInputEngineSpeed: set at pre-compile, destination=[DemDataElementClass/DemExternalCSDataElementClass, DemDataElementClass/DemExternalSRDataElementClass]  # Input variable for the engine speed, which is assigned to a specific data element used as interface for the Dem-internal PID calculations.
        choice reference DemOBDInputEngineTemperature: set at pre-compile, destination=[DemDataElementClass/DemExternalCSDataElementClass, DemDataElementClass/DemExternalSRDataElementClass]  # Input variable for the engine temperature, which is assigned to a specific data element used as interface for the Dem-internal PID calculations.
        choice reference DemOBDInputProgrammingEvent: set at pre-compile, destination=[DemDataElementClass/DemExternalCSDataElementClass, DemDataElementClass/DemExternalSRDataElementClass]  # Input variable for the programming event, which is assigned to a specific data element used as interface for the Dem-internal PID calculations.
        choice reference DemOBDInputVehicleSpeed: set at pre-compile, destination=[DemDataElementClass/DemExternalCSDataElementClass, DemDataElementClass/DemExternalSRDataElementClass]  # Input variable for the vehicle speed, which is assigned to a specific data element used as interface for the Dem-internal PID calculations.
      container DemGroupOfDTC [0..255]  # This container contains the configuaration (parameters) for DTC groups.
        integer DemGroupDTCs: 0..16777214, set at pre-compile, symbolic-name-value=true  # DTC value of the selected group of DTC | (Range: 3 byte, 0x000000 is only available for the emission-related DTC group, 0xFFFFFF is reserved for 'all DTCs', according to ISO14229-1 Annex D.1,) The DTC group 'all DTCs' is always available and will not be configured.
      container DemIndicator [0..255]  # This container contains the configuration (parameters) for Indicators. | Note that this container definition does not explicitly define a symbolic name parameter. Instead, the short name of the container will be used in the Ecu Configuration Description to specify the symbolic name of the INDICATOR_NAME.
        integer DemIndicatorID: 0..255, set at pre-compile, symbolic-name-value=true  # Unique identifier of an indicator.
        string DemIndicatorDescription [0..1]
        string DemIndicatorSource [0..1]
        string DemIndicatorHierarchyName [0..1]
        string DemIndicatorDisplayName [0..1]  # May contain an element specific more human-readable name to substitute the shortname
        string DemIndicatorModuleName [0..1]
        string DemIndicatorPureFunctionName [0..1]
        string DcnfxmlFileSource [0..1]
        choice container DemIndicatorBackRef [0..1]
          container DemIndicatorSWC [0..1]
            instance reference DemIndicatorSwcInternalBehaviorRef: origin=ServiceNeeds_UseCase_Realization, destination-context=ROOT-SW-COMPOSITION-PROTOTYPE SW-COMPONENT-PROTOTYPE, destination-type=SWC-INTERNAL-BEHAVIOR
            foreign reference DemIndicatorSwcServiceDependencyRef: origin=ServiceNeeds_UseCase_Realization, destination-type=SWC-SERVICE-DEPENDENCY
      container DemNvRamBlockId [0..*]  # This container contains the configuaration (parameters) for a non-volatile memory block, which is used from the Dem. If no permanent storage of event memory entries is required, no block needs to be configured. | The number of blocks which are necessary depends on the implementation and configuration (e.g. number of used event memories) of the Dem module.
        symbolic name reference DemNvRamBlockIdRef: set at pre-compile, origin=AUTOSAR_ECUC V1.0.0, destination=NvMBlockDescriptor  # This reference contains the link to a non-volatile memory block. For post build time configurations worst case szenario shall be used.
      container DemOperationCycle [1..256]  # Note that this container definition does not explicitly define a symbolic name parameter. Instead, the short name of the container will be used in the Ecu Configuration Description to specify the symbolic name of the operation cycle name.
        enumeration DemOperationCycleType: {DEM_OPCYC_IGNITION, DEM_OPCYC_OBD_DCY, DEM_OPCYC_OTHER, DEM_OPCYC_POWER, DEM_OPCYC_TIME, DEM_OPCYC_WARMUP}, set at pre-compile  # Operation cycles types for the Dem to be supported by cycle-state APIs. | Further cycle types can be specified as part of the Dem delivery.
        enumeration DemOperationCycleProcessing: {DEM_PROCESS_OPCYC_STATE, DEM_PROCESS_OPCYC_COUNTER, DEM_PROCESS_OPCYC_INTERNAL}
        choice container DemOperationCycleBackRef [0..1]
          container DemOperationCycleSWC [0..1]
            instance reference DemOperationCycleSwcInternalBehaviorRef: origin=ServiceNeeds_UseCase_Realization, destination-context=ROOT-SW-COMPOSITION-PROTOTYPE SW-COMPONENT-PROTOTYPE, destination-type=SWC-INTERNAL-BEHAVIOR
            foreign reference DemOperationCycleSwcServiceDependencyRef: origin=ServiceNeeds_UseCase_Realization, destination-type=SWC-SERVICE-DEPENDENCY
      container DemRatioId [0..65535]  # This container contains the OBD specific ratio Id configuraiton. It is related to a specific event, a FID, and an IUMPR group. | Note that this container definition does not explicitly define a symbolic name parameter. Instead, the short name of the container will be used in the Ecu Configuration Description to specify the symbolic name of the ratio Id name.
        enumeration DemIUMPRGroup: {DEM_IUMPR_BOOSTPRS, DEM_IUMPR_CAT1, DEM_IUMPR_CAT2, DEM_IUMPR_EGR, DEM_IUMPR_EGSENSOR, DEM_IUMPR_EVAP, DEM_IUMPR_NMHCCAT, DEM_IUMPR_NOXADSORB, DEM_IUMPR_NOXCAT, DEM_IUMPR_OXS1, DEM_IUMPR_OXS2, DEM_IUMPR_PMFILTER, DEM_IUMPR_PRIVATE, DEM_IUMPR_SAIR, DEM_IUMPR_SECOXS1, DEM_IUMPR_SECOXS2, DEM_IUMPR_FLSYS, DEM_IUMPR_NONE, DEM_IUMPR_AFRI1, DEM_IUMPR_AFRI2, DEM_IUMPR_PF1, DEM_IUMPR_PF2}, set at pre-compile  # This parameter specifies the assigned IUMPR group of the ratio Id.
        boolean DemIUMPRMileage [0..1]
        enumeration DemRatioIdType: {DEM_RATIO_API, DEM_RATIO_OBSERVER}, set at pre-compile  # This parameter defines whether the ratio Id will be calculated API or observer based.
        string DemErrmRatioCallback [0..1]
        string DemRatioSource [0..*]
        string DemErrmPrmNrConf [0..1]
        boolean DemErrmDenominatorInterfaceUsed [0..1]
        integer DemRatioId [0..1]: 0..65535, symbolic-name-value=true
        boolean DemErrmArrayAccessSuppressed [0..1]
        boolean DemErrmCalibratable [0..1]
        boolean DemRatioIdTypeIsCalibratable [0..1]
        string DemRatioIdHierarchyName [0..1]
        string DemRatioIdDisplayName [0..1]  # May contain an element specific more human-readable name to substitute the shortname
        string DemRatioModuleName [0..1]
        string DemRatioPureFunctionName [0..1]
        string DcnfxmlFileSource [0..*]
        reference DemDiagnosticEventRef [0..*]: set at pre-compile, destination=DemConfigSet/DemEventParameter  # This reference contains the link to a diagnostic event.
        symbolic name reference DemFunctionIdRef: set at pre-compile, destination=FiMFID  # This reference contains the link to a function identifier within the FiM which is used as a primary FID.
        symbolic name reference DemSecondaryFunctionIdRef [0..*]: set at pre-compile, destination=FiMFID  # This reference contains the link to a function identifier within the FiM which is used as a secondary FID. | The "primary" and all "secondary" FID inhibitions are combined by "OR".
        choice container DemRatioIdBackRef [0..1]
          container DemRatioIdSWC [0..1]
            instance reference DemRatioIdSwcInternalBehaviorRef: origin=ServiceNeeds_UseCase_Realization, destination-context=ROOT-SW-COMPOSITION-PROTOTYPE SW-COMPONENT-PROTOTYPE, destination-type=SWC-INTERNAL-BEHAVIOR
            foreign reference DemRatioIdSwcServiceDependencyRef: origin=ServiceNeeds_UseCase_Realization, destination-type=SWC-SERVICE-DEPENDENCY
          container DemRatioIdBSW [0..1]
            foreign reference DemRatioIdObdRatioServiceNeedsRef: origin=ServiceNeeds_UseCase_Realization, destination-type=OBD-RATIO-SERVICE-NEEDS
      container DemStorageCondition [0..255]  # This container contains the configuration (parameters) for storage conditions.
        integer DemStorageConditionId: 0..255, set at pre-compile, symbolic-name-value=true  # Defines a unique storage condition Id. This parameter should not be changeable by user, because the Id should be generated by Dem itself to prevent gaps and multiple use of an Id. The storage conditions should be sequentially ordered beginning with 0 and no gaps in between.
        boolean DemStorageConditionStatus: set at pre-compile  # Defines the initial status for enable or disable of storage of a diagnostic event. | The value is the initialization after power up (before this condition is reported the first time). true: storage of a diagnostic event enabled false: storage of a diagnostic event disabled
        choice container DemStorageConditionBackRef [0..1]
          container DemStorageConditionSWC [0..1]
            instance reference DemStorageConditionSwcInternalBehaviorRef: origin=ServiceNeeds_UseCase_Realization, destination-context=ROOT-SW-COMPOSITION-PROTOTYPE SW-COMPONENT-PROTOTYPE, destination-type=SWC-INTERNAL-BEHAVIOR
            foreign reference DemStorageConditionSwcServiceDependencyRef: origin=ServiceNeeds_UseCase_Realization, destination-type=SWC-SERVICE-DEPENDENCY
      container DemStorageConditionGroup [0..255]  # This container contains the configuration (parameters) for storage condition groups.
        reference DemStorageConditionRef [1..255]: set at pre-compile, origin=AUTOSAR_ECUC V1.0.0, destination=DemGeneral/DemStorageCondition  # References an enable condition.
      container DemGeneralDiagnosticInfo [0..*]  # This container contains the configuration (parameters) for DemGeneralDiagnosticInfo.
        function name GeneralDiagnosticInfoFnc [0..1]: set at pre-compile  # C function name
        choice container BackRef [0..1]
          container BackRefSWC [0..1]
            instance reference SwcInternalBehaviorRef: origin=ServiceNeeds_UseCase_Realization, destination-context=ROOT-SW-COMPOSITION-PROTOTYPE SW-COMPONENT-PROTOTYPE, destination-type=SWC-INTERNAL-BEHAVIOR
            foreign reference SwcServiceDependencyRef: origin=ServiceNeeds_UseCase_Realization, destination-type=SWC-SERVICE-DEPENDENCY
          container BackRefBSW [0..1]
            foreign reference BswServiceNeedsBackref: origin=ServiceNeeds_UseCase_Realization, destination-type=DIAGNOSTIC-EVENT-MANAGER-NEEDS
      container DemDataElementConsistencyNeeds [0..1]
        container DemDataElementConsistencyNeed [1..*]
          reference DemDataElementConsistencyNeedClassRef [2..*]: destination=DemDataElementClass/DemExternalCSDataElementClass
      container EvMemOverflowIndication [0..*]  # This container contains the configuration for the EvMemOverflowIndication client-server interface.
        choice container BackRef [0..1]
          container BackRefSWC [0..1]
            instance reference SwcInternalBehaviorRef: origin=ServiceNeeds_UseCase_Realization, destination-context=ROOT-SW-COMPOSITION-PROTOTYPE SW-COMPONENT-PROTOTYPE, destination-type=SWC-INTERNAL-BEHAVIOR
            foreign reference SwcServiceDependencyRef: origin=ServiceNeeds_UseCase_Realization, destination-type=SWC-SERVICE-DEPENDENCY
      container GeneralCallbackEventDataChanged [0..*]  # This container contains the configuration (parameters) for DemGeneralDiagnosticInfo.
        function name GeneralCallbackEventDataChangedFnc [0..1]: set at pre-compile  # C function name
        choice container BackRef [0..1]
          container BackRefSWC [0..1]
            instance reference SwcInternalBehaviorRef: origin=ServiceNeeds_UseCase_Realization, destination-context=ROOT-SW-COMPOSITION-PROTOTYPE SW-COMPONENT-PROTOTYPE, destination-type=SWC-INTERNAL-BEHAVIOR
            foreign reference SwcServiceDependencyRef: origin=ServiceNeeds_UseCase_Realization, destination-type=SWC-SERVICE-DEPENDENCY
          container BackRefBSW [0..1]
            foreign reference BswServiceNeedsBackref: origin=ServiceNeeds_UseCase_Realization, destination-type=DIAGNOSTIC-EVENT-MANAGER-NEEDS
      container GeneralCallbackEventStatusChange [0..*]  # This container contains the configuration (parameters) for DemGeneralDiagnosticInfo.
        function name GeneralCallbackEventStatusChangeFnc [0..1]: set at pre-compile  # C function name
        choice container BackRef [0..1]
          container BackRefSWC [0..1]
            instance reference SwcInternalBehaviorRef: origin=ServiceNeeds_UseCase_Realization, destination-context=ROOT-SW-COMPOSITION-PROTOTYPE SW-COMPONENT-PROTOTYPE, destination-type=SWC-INTERNAL-BEHAVIOR
            foreign reference SwcServiceDependencyRef: origin=ServiceNeeds_UseCase_Realization, destination-type=SWC-SERVICE-DEPENDENCY
          container BackRefBSW [0..1]
            foreign reference BswServiceNeedsBackref: origin=ServiceNeeds_UseCase_Realization, destination-type=DIAGNOSTIC-EVENT-MANAGER-NEEDS
      container DemClient [0..255]  # This container contains possible clients that are using the Dem APIs.
        enumeration DemClientFunctionality: default-value=DEM_CLIENT_USES_FULL_FUNCTIONALITY
          DEM_CLIENT_ONLY_USES_EVENTOVERFLOW_INTERFACE  # The Dem provides only the client related functionality EvMemOverflowIndication for this client Id. Other functionality like DTCFilter or Clear is not allowed to be used by this client.
          DEM_CLIENT_USES_FULL_FUNCTIONALITY  # The Dem provides all client related functionality for the selected client (e.g. clear APIs and overflow indications).
        integer DemClientId: 0..255, symbolic-name-value=true  # Defines a unique identifier for a Dem client. This number is used by this client in the ClientID parameter in all API with this parameter.
        boolean DemClientUsesRte: default-value=false  # If set to true, this client shall only use the DEM via RTE (Dem will provide the C/S interfaces: CddIf, EvMemOverflowIndication). The client must not do any C_API calls to the DEM.
        string DemClientDisplayName [0..1]
        string DemClientDescription [0..1]
        string DemClientSource [0..*]
        string DemClientHierarchyName [0..1]
        container DemCallbackDTCStatusChanged [0..*]  # The presence of this container indicates, that the Dem has access to a "DTCStatusChanged" callback, which the Dem will call to notify other components about the change in the status of a DTC. In case there is a DemCallbackDTCStatusChangedFnc, this parameter defines the name of the function that the Dem will call. In case there is no DemCallbackDTCStatusChangedFnc, the Dem will have an R-Port requiring the interface CallbackDTCStatusChanged whose name is generated by using the unique callback-prefix followed by the event name. Status change notifications are supported for DTCs in primary memory only.
          function name DemCallbackDTCStatusChangedFnc [0..1]
          string DcnfxmlFileSource [0..1]
          choice container DemCallbackDTCStatusChangedBackRef [0..1]
            container DemCallbackDTCStatusChangedSWC [0..1]
              instance reference DemCallbackDTCStatusChangedSwcInternalBehaviorRef: origin=ServiceNeeds_UseCase_Realization, destination-context=ROOT-SW-COMPOSITION-PROTOTYPE SW-COMPONENT-PROTOTYPE, destination-type=SWC-INTERNAL-BEHAVIOR
              foreign reference DemCallbackDTCStatusChangedSwcServiceDependencyRef: origin=ServiceNeeds_UseCase_Realization, destination-type=SWC-SERVICE-DEPENDENCY
            container DemCallbackDTCStatusChangedBSW [0..1]
              foreign reference DemCallbackDTCStatusChangedDiagnosticEventNeedsRef: origin=ServiceNeeds_UseCase_Realization, destination-type=DIAGNOSTIC-EVENT-MANAGER-NEEDS
        choice container DemClientBackRef [0..1]
          container DemClientSWC [0..1]
            instance reference DemClientSwcInternalBehaviorRef: origin=ServiceNeeds_UseCase_Realization, destination-context=ROOT-SW-COMPOSITION-PROTOTYPE SW-COMPONENT-PROTOTYPE, destination-type=SWC-INTERNAL-BEHAVIOR
            foreign reference DemClientSwcServiceDependencyRef: origin=ServiceNeeds_UseCase_Realization, destination-type=SWC-SERVICE-DEPENDENCY
