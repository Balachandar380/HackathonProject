AUTOSAR XML (schema 4-0-3)
package /Continental_08/PowerSAR/ICSP/EcuModuleDefs
  module config DemGenr
    Cores: NumberOfUsersPerSemaphore=65535
      3 x Core, all with RelativePerformance=100:
        A{0..2}: CycleEndFunction01=Func_A{0..2}_CycObdEnd_01, CycleEndFunction02=Func_A{0..2}_CycObdEnd_02
    NvmSpc:
      Elements_Rpg = ERRM_DCMNG_LV_RBM_GEN_DEN_MEM
      Elements_Rpg = ERRM_DCMNG_CTR_FUEL_ENG_CYC_OBD_LBYTE
      Elements_Rpg = ERRM_DCMNG_CTR_FUEL_ENG_CYC_OBD_HBYTE
      Elements_Rpg = ERRM_DCMNG_DIST_RBM_LBYTE
      Elements_Rpg = ERRM_DCMNG_DIST_RBM_HBYTE
      Elements = ERRM_STATIS_DIST_ACT_MIL_INTM
      Elements = ERRM_STATIS_DIST_DTC_CLR_INTM
      Elements = ERRM_STATIS_LV_MIL_REQ_TOT_PREV
      Elements = ERRM_STATIS_T_ACT_MIL_60
      Elements = ERRM_STATIS_T_DTC_CLR_60
      Elements = ERRM_DCMNGAI_DIST_INC_HBYTE
      Elements = ERRM_DCMNGAI_DIST_INC_LBYTE
      Elements = ERRM_LAMPMNGAI_CTR_WUP
      Elements = ERRM_LAMPMNGAI_STATE_EXT_MIL_REQ
      Elements = ERRM_LAMPMNGAI_LF_MIL_EXT_OBD_ECU_LBYTE
      Elements = ERRM_LAMPMNGAI_LF_MIL_EXT_OBD_ECU_HBYTE
      Elements = ERRM_RBMAI_DIST_IUMPR_CLR_HBYTE
      Elements = ERRM_RBMAI_DIST_IUMPR_CLR_LBYTE
      Elements = ERRM_RBMAI_DIST_IUMPR_CLR_INTM
      Elements = ICSP_DEM_CNF_MAN_CTR_KM_CAN_ENVD_HBYTEHWORD
      Elements = ICSP_DEM_CNF_MAN_CTR_KM_CAN_ENVD_LBYTEHWORD
      Elements = ICSP_DEM_CNF_MAN_CTR_KM_CAN_ENVD_HBYTELWORD
      Elements = ICSP_DEM_CNF_MAN_CTR_KM_CAN_ENVD_LBYTELWORD
      Elements = ERRM_DUMMY_1
