AUTOSAR XML (schema 4-0-3)
package /Continental_08/PowerSAR/ICSP/EcuModuleDefs
  module definition DemGenr: variants pre-compile
    container Cores
      integer NumberOfUsersPerSemaphore: 1..65535, default-value=65535  # User-objects (e.g. Dtrs) protected by semaphores may share the same. Configured to 1 each element gets its own semaphore, configuring a number large than the number of user objects uses the same semaphore for all.
      container Core [1..32]
        integer RelativePerformance: 0..255, default-value=100
        string CycleEndFunction01  # Name of the void/void function to be called during the c01 part of the transitions Off2On, ClrFmy, DemIt, and Sdn if the OBD cycle needs to be ended.
        string CycleEndFunction02  # Name of the void/void function to be called during the c02 part of the transitions Off2On, ClrFmy, DemIt, and Sdn if the OBD cycle needs to be ended.
        reference EcucPartitionRef [0..1]: destination=EcucPartition
    container General
      enumeration EngineType: {GASOLINE, DIESEL, GASOLINE_and_DIESEL_by_calibration}
      string Variants [0..255]: requires-index=true, regular-expression=[a-zA-Z0-9]*  # Names of variants. All data selected as "variant specific" is generated separately for each variant. If no variants are selected, data will be generated once, without variant-specific extended names.
      boolean TypEngVariant  # Set the calibratable engine type to be variant specific
      boolean WarnAboutMissingCalibration  # Log a warning about every calibration item not set by calibration data import (e.g., .dcm file)
      enumeration WWH_OBD: {DISABLED, ENABLED_B1_DISABLED, ENABLED_B1_ENABLED}
      function name CallbackClearConditionFcn [0..1]: set at pre-compile  # Name of the function/action to query the condition to clear failure memory
      boolean NvmWrRunAllEna [0..1]: default-value=false  # NvM write on the fly (during run-time) on request or clear enabled (default = false)
      integer NvmWrRunNrFmy [0..1]: -1..127, default-value=0  # Number of NvM write buffers for Fmy[] (default = -1) -1 : Fmy struct merged in main Nvm block 0 : 1 Fmy Nvm block per Fmy entry. On fly storage not active. >0 : On Fly storage active with defined number of buffers
    container Bench [0..1]
      integer NrBench: 0..255, default-value=0  # Number of bench entries
    container Class
      integer NumberOfClasses: 1..255, default-value=20  # Number of failure classes
      boolean StLvlDiagEnabled  # Enable the serverity calibration per class
      boolean StLvlDiagVariant  # Set the severity / OBD class calibration to be variant specific
      boolean StPrioDiagSrvVariant  # Set the priority calibration to be variant specific
      boolean CtrCycCfmVariant  # Set the cycle counter to confirm an Event to be variant specific
      boolean CtrCycHealVariant  # Set the cycle counter to heal an Event to be variant specific
      boolean CtrAgiThdVariant  # Set the aging threshold calibration to be variant specific
      boolean StAgiStgyVariant  # Set the aging strategy calibration to be variant specific
      boolean StLampVariant  # Set the lamp relevance calibration to be variant specific
      enumeration IdxClass [0..1]: {CENTRAL, USER}, default-value=CENTRAL  # Selects if the failure class selection IdxClass shall be assigned centrally or to the user in the A2L (default: CENTRAL)
      boolean IdxClassVariant  # Set the class index of failures to be variant specific
      enumeration StPrioIntmDiagSrv [0..1]: {DISABLED, NORMAL, VARIANT}, default-value=DISABLED  # Enables the StPrioIntmDiagSrv instead of StPrioDiagSrv to select the priority for intermittent failure entries. With NORMAL, only a single instance of the map is generated, with VARIANT a map is generated per calibration variant. Has no effect when intermittent-storage is disabled.
      enumeration IdxClassIntm [0..1]: {DISABLED, USER, CENTRAL}, default-value=DISABLED  # Enables IdxClassIntm instead of IdxClass to be used to select the intermittent priority. Calibration is assigned in the A2L according to the selection. Has no effect when intermittent-storage is disabled.
      enumeration StSrvSec [0..1]: {DISABLED, NORMAL, VARIANT}, default-value=DISABLED  # Enables reporting of failures in secondary memory
      integer IdxClassDefaultValue [0..1]: 0..255, default-value=0  # Default value for all Icsp_Dem_Class_IdxClass_<event>
      integer IdxClassIntmDefaultValue [0..1]: 0..255, default-value=0  # Default value for all Icsp_Dem_Class_IdxClassIntm_<event>
      container CalibrationClasses [0..1]
        container CalibrationClass [0..1]  # Calibration class with configurable content
          container Element [1..255]  # Configurable elements (index maximum limit: NumberOfClasses)
            integer Index: 0..255
            string Name
    container DcmIf
      boolean StObdReqVariant: default-value=false  # Sets the calibration of the OBD requirement (PID 1C) to be variant specific (e.g., if variants are US and EU, different values are reported)
      string AuxIdControlDtcSetting [0..16]  # Names of auxiliary inputs (EMS2 style, without prefix) to be set during Service 85 "Control DTC Setting"
      enumeration StatusOfDtcFailedSinceLastClear [0..1]: {InFmy, LvErrClr}, default-value=LvErrClr  # Reporting of the bit "failed since last clear" (bit 5) in StatusOfDtc on UDS: LvErrClr = report Icsp_Dem_Deb_LvErrClr, i.e., failed since last clear (default) InFmy = report as 1 when the Event is stored in Fmy as failed
    container Deb
      boolean AllEventsDisabledByDefault: default-value=true  # Set the LfIniTyp of all Events to disabled by default
      enumeration LfIniTyp [0..1]: {CENTRAL, USER}, default-value=USER  # Selects if the initialization-type LfIniTyp shall be assigned centrally or to the user in the A2L (default: USER)
      enumeration LfCdnSel [0..1]: {Autosar_WithoutFid_USER, Autosar_WithoutFid_CENTRAL, Autosar_USER, Autosar_CENTRAL, All_WithoutFid_USER, All_WithoutFid_CENTRAL, All_USER, All_CENTRAL, DISABLED}, default-value=DISABLED  # Configures the enable-condition calibration per Event. With DISABLED, the calibration is not available at all. The other options consist of two parts: The first part selects for which Events the enable-condition is available; "Autosar" enables it only for diagnostics configured as SWC or BSW, "All_WithoutFid" enables it for all Events that have no "inhibiting FID" documented, and "All" enables it for all Events. The second part selects whether the LfCdnSel shall be assigned centrally or to the user in the A2L. Default: DISABLED.
      string LfCndSelVisiblityPattern [0..1]  # The Enable condiitons are visible for only those diagnosis with the short name that matches the string pattern entered here.This pattern search is a logical AND with the visbility configuration through the parameter "LfCdnSel". A regular expression shall be entered.For e.g you shall enter .*Abc.* to filter all Diagnosis with Abc as part of its display name and Abc.* to filter all Diagsnostics with name starting with Abc. Its also important to note the string is case sensitive.
      boolean LfIniTypVariant [0..1]  # Set the initialisation type for an Event to be variant specific
      container Mapping
        enumeration DemDebounceUnknown: {DemDebounceLegacyS8, DemDebounceLegacyS16, DemDebounceMonitorInternal, DemDebounceLegacyS15Min, DemDebounceCounterBased}
        enumeration DemDebounceCounterBased [0..1]: {DemDebounceLegacyS8, DemDebounceLegacyS16, DemDebounceLegacyS15Min, DemDebounceCounterBased}
        enumeration DemDebounceTimeBase [0..1]: {DemDebounceLegacyS8, DemDebounceLegacyS16, DemDebounceLegacyS15Min, DemDebounceCounterBased}
        enumeration DemDebounceLegacyS8 [0..1]: {DemDebounceLegacyS8, DemDebounceLegacyS16, DemDebounceLegacyS15Min, DemDebounceCounterBased}
        enumeration DemDebounceLegacyS16 [0..1]: {DemDebounceLegacyS8, DemDebounceLegacyS16, DemDebounceLegacyS15Min, DemDebounceCounterBased}
        enumeration DemDebounceLegacyS15Min [0..1]: {DemDebounceLegacyS8, DemDebounceLegacyS16, DemDebounceLegacyS15Min, DemDebounceCounterBased}
        enumeration DemDebounceLegacyMpl: {DemDebounceLegacyS8, DemDebounceLegacyS16, DemDebounceLegacyS15Min, DemDebounceCounterBased}
        enumeration DemDebounceLegacyCalClas: {DemDebounceLegacyS8, DemDebounceLegacyS16, DemDebounceLegacyS15Min, DemDebounceCounterBased}
        enumeration DemDebounceLegacyConfClas: {DemDebounceLegacyS8, DemDebounceLegacyS16, DemDebounceLegacyS15Min, DemDebounceCounterBased}
        enumeration DemDebounceLegacyStc: {DemDebounceLegacyS8, DemDebounceLegacyS16, DemDebounceLegacyS15Min, DemDebounceCounterBased}
        enumeration DemDebounceMonitorInternal [0..1]: {DemDebounceMonitorInternal}
      container EnableConditions [0..1]
        container EnableCondition [0..32]
          integer Index
          string DemEnableConditionNameRef
          boolean ControlDtcSetting [0..1]  # If enabled, Icsp_Dem sets this enabled condition based on the ControlDtcSetting status for DTC 0xFFFFFF (all) set by Dcm. Can only be set to TRUE for a maximum of one enable condition. Cannot be enabled at the same time as Icsp_Fim auxiliary inputs in DemGenr/DcmIf/AuxIdControlDtcSetting. Default is FALSE.
          string Description [0..1]
          boolean EnableConditionStatusInitial [0..1]
          boolean DisablesPid0x41 [0..1]: default-value=false  # If set to TRUE, an inhibition through this EnableCondition will set the PID 0x41 enable status to disabled for the group that the inhibited Events belong to. Typicall set to TRUE for EnableConditions like "not high altitude", and typically set to FALSE for "key on".
    container DebCtr [0..1]
      boolean AbcMinFixed [0..1]: default-value=false  # Set the ABC Min fixed(freezed) or unfixed(calibration)
      boolean AbcMaxFixed [0..1]: default-value=false  # Set the ABC Max fixed(freezed) or unfixed(calibration)
      boolean AbcIncFixed [0..1]: default-value=false  # Set the ABC Inc fixed(freezed) or unfixed(calibration)
      boolean AbcDecFixed [0..1]: default-value=false  # Set the ABC Dec fixed(freezed) or unfixed(calibration)
      boolean JumpUpFixed [0..1]: default-value=false  # Set the JumpUp fixed(freezed) or unfixed(calibration)
      boolean JumpDownFixed [0..1]: default-value=false  # Set the Jump Down fixed(freezed) or unfixed(calibration)
      integer AbcMinForced [0..1]: -32768..-1, default-value=-15  # Abc Min forced value
      integer AbcMaxForced [0..1]: 1..32767, default-value=15  # Abc Max forced value
      integer AbcIncForced [0..1]: 1..32767, default-value=1  # Abc Inc forced value
      integer AbcDecForced [0..1]: 1..32768, default-value=2  # Abc Dec forced value
      integer JumpUpForced [0..1]: -32768..32767, default-value=0  # Jump Up forced value
      integer JumpDownForced [0..1]: -32768..32767, default-value=32767  # Jump Down forced value
    container Dtc
      enumeration ObdDtc: {Icsp_Dem_Dtc_DtcObd}  # Selects the data to use as OBD DTCs
      enumeration UdsDtc16bitPart: {Icsp_Dem_Dtc_DtcObd, Icsp_Dem_Dtc_DtcCus}  # Selects the data to use as UDS DTCs (either the same as OBD, or separate values).
      enumeration UdsDtc8bitPart [0..1]: {Icsp_Dem_Dtc_DtcInfo}  # Selects an additional byte to be added to the UDS DTC (optional). Typically used as 3rd byte when using OBD DTCs on UDS, together with Uds16bitIsLowPart = false.
      boolean UdsDtc16bitIsLowPart  # Selects whether the 16 bit part of the UDS DTC (as selected in Uds16bitPart) is the low or high 2 bytes (and 8 bit part is high or low byte). Typically, if the UDS DTC is the OBD DTC, the 8 bit part is the 3rd byte (this option set to false). If the UDS DTC is a separate one, the 16 bit part may be high or low part.
      enumeration UdsDtcTranslationType: {DEM_DTC_TRANSLATION_ISO15031_6, DEM_DTC_TRANSLATION_ISO14229_1, DEM_DTC_TRANSLATION_SAEJ1939_73, DEM_DTC_TRANSLATION_ISO11992_4, DEM_DTC_TRANSLATION_SAEJ2012_DA_04}  # Selects the translation type reported on UDS. Typically set to ISO15031-6 when OBD DTCs are used on UDS, or ISO14229-1 when separate DTCs are used.
      enumeration UdsDtcTranslationTypeEmi: {DEM_DTC_TRANSLATION_SAEJ1939_73, DEM_DTC_TRANSLATION_SAEJ2012_DA_04}  # Selects the translation type reported on UDSfor emission.
      enumeration DtcDisplayFmy: {DISABLED, OBD, UDS}  # Icsp_Dem can display a DTC for each entry in Fmy. This option selects whether to disable this feature, or which DTC style to display (OBD or UDS DTCs).
      enumeration DtcAssignment: {CENTRAL, USER}, default-value=CENTRAL  # Moves the DTC calibration to Icsp_Dem_Dtc (CENTRAL) or the related diagnostics (USER).
      container DtcGroups
        container DtcGroup [0..255]
          enumeration DtcKind: {OBD, UDS}
          integer DtcRangeMin
          integer DtcRangeMax
          enumeration Origin [0..1]: {DEM_DTC_ORIGIN_PRIMARY_MEMORY, DEM_DTC_ORIGIN_SECONDARY_MEMORY, DEM_DTC_ORIGIN_NONE}, default-value=DEM_DTC_ORIGIN_PRIMARY_MEMORY
          boolean ExecuteSysTranClrFmy
          enumeration SelectedEvents: {ALL, SRV_CUS, BY_DTC, NONE}
          string EnaInVariants [1..8]  # A list of variant names, e.g. 'US', 'EU', in which these feature shall be enabled. A '*' means for all variants.
          boolean LvNvmWrOnClr [0..1]: default-value=false  # When clearing this group, write to Nvm
          boolean LvClrHis [0..1]  # Allows clearing of HIS memory together with Clear DTC command.Hint: Clear-condition callback will be verified as well, if HIS memory-type can be cleared.
          boolean LvClrDwis [0..1]  # Allows clearing of DWIS memory together with Clear DTC command.Hint: Clear-condition callback will be verified as well, if DWIS memory-type can be cleared.
          boolean LvClrPerm [0..1]  # Allows clearing of PERM memory together with Clear DTC command.Hint: Clear-condition callback will be verified as well, if PERM memory-type can be cleared.
    container Dtr
      boolean Enabled: default-value=true  # Enables the diagnostic test result (Mode $06) handler
      boolean UseAlternativeUnits: default-value=false  # Switches the display of value/min/max to use the alternative units
      enumeration TidAssignment: {CAL_TUNABLE_CENTRAL, CAL_TUNABLE_USER}, default-value=CAL_TUNABLE_USER  # Selects where to assign the TID calibration to in the A2L.
      integer NumberOfSparesPerUsedMid: 0.., default-value=0  # The number of spares per used obd-mid.
      boolean DtrMidsCalibratable: default-value=true  # DtrsCalibratable
    container Dwis
      integer NrEveDwis: 0..224  # Enter number of entries for Icsp_Dem_Dwis_StCalDwis calibration used to assign Events to Dwis Groups. Set to 0 to disable Dwis feature.
      string NameEveExt [0..65535]  # Dwis external inducement requests from other Control Units
      enumeration GrpPid88h [0..1]: {DISABLED, ENABLED_WITH_STATE_MACHINE, ENABLED_WITHOUT_STATE_MACHINE}  # DISABLED : Pid$88h not computed ENABLED_WITHOUT_STATE_MACHINE : Pid$88h computed, no state machine computed for PID$88h groups (default) ENABLED_WITH_STATE_MACHINE : Pid$88h computed, state machine computed for each PID$88h groups
      enumeration GrpPid94h [0..1]: {DISABLED, ENABLED_WITH_STATE_MACHINE, ENABLED_WITHOUT_STATE_MACHINE}  # DISABLED : Pid$94h not computed ENABLED_WITHOUT_STATE_MACHINE : Pid$88h computed, no state machine computed for PID$94h groups (default) ENABLED_WITH_STATE_MACHINE : Pid$88h computed, state machine computed for each PID$94h groups
      enumeration GrpRest [0..1]: {DISABLED, ENABLED_WITH_STATE_MACHINE, ENABLED_WITHOUT_STATE_MACHINE}  # DISABLED :Temporary restart feature is disabled ENABLED_WITHOUT_STATE_MACHINE :Temporary restart feature is enabled, no state machine computed for RestInh and RestPrms groups (default) ENABLED_WITH_STATE_MACHINE :Temporary restart feature is enabled, state machine computed for RestInh and RestPrms groups
      string GrpSpcWithStateMachine [0..65535]  # Specify groups with state machine
      string GrpSpcWithoutStateMachine [0..65535]  # Specify groups without state machine
      boolean NvmResistantToChangedSw [0..1]: default-value=false  # Set the DWIS storage block to not be reset on software change / reprogramming (requires the configuration/calibration to be sufficiently similar for the data to survive). Default: false.
    container Fmy
      integer NrFmy: 1..127, default-value=15  # Number of dynamic failure entries
      boolean IntmEna [0..1]: default-value=false  # Activates the intermittent failure management. If enabled, Fmy will log failure once Fdc > 0
      enumeration MilGrouping: {DISABLED, ROM_INVISIBLE, CAL_READONLY_CENTRAL, CAL_READONLY_USER, CAL_TUNABLE_CENTRAL, CAL_TUNABLE_USER}, default-value=CAL  # Selects the MIL grouping variant (memory location, tunable/readonly, a2l label assignment to Icsp_Dem or diagnostics).
      string ReconfirmImmediatelyInVariants [0..8]  # A list of variant names, e.g. 'US', 'EU', in which these feature shall be enabled. A '*' means for all variants. An empty list means never.
      string AgingWhileHealingInVariants [0..8]  # A list of variant names, e.g. 'US', 'EU', in which these feature shall be enabled. A '*' means for all variants. An empty list means never.
    container FmyCtrCus
      container CtrCus [0..8]
        boolean PreventIncFirstCycle
        boolean PreventUpdOnIntm
        enumeration IncTrigger: {CycEnd, Chg}
        enumeration IncCondition: {Fail, PassNoFail, Always, Intm, IntmOrPass}
        enumeration RstTrigger [0..1]: {CycEnd, Chg}
        enumeration RstCondition [0..1]: {Fail, PassNoFail, Always, Intm, IntmOrPass}
    container Frf
      enumeration CalibrationAssignment [0..1]: {CENTRAL, USER}, default-value=CENTRAL  # Moves the data element selection labels for calibratable freeze-frames to CENTRAL or USER (related Event). Default CENTRAL.
      container FreezeFrameServices  # Configuration of all freeze frame services
        container FreezeFrameService [0..2]  # Freeze Frame configuration
          enumeration ServiceType: {SERVICE_19_06h, SERVICE_19_04h}  # Type of service (available configuration: 19 06h and 19 04h)
          boolean UseUdsObdRange: default-value=false  # If active, only the records between 0x8F > and < 0xF0 with OBD relevant DTCs are taken into account by the service
          boolean SortRecordsByShortName [0..1]: default-value=false  # If active, records are sorted based on the shortname and appear in this order on record FFh/FEh. If this is not set, the records are sorted based on the recordnumber and appear in this order on record FFh/FEh.
          symbolic name reference DefaultRecordNumber [0..1]: destination=Record  # If active and a non-existing recordnumber is requested by customer, the configured defaultnumber will be send instead of wrong record response
          container Record [0..*]  # Record configuration
            integer RecordNumber: 0..256, default-value=0  # Recordnumber
            boolean ObdRelevant: default-value=false  # If active, only OBD relevant DTCs will be taken into account
            string FctToOverWriteBuf [0..1]  # If function name added, the content per record can be overwritten inside the function
            enumeration OutputRlv [1..*]: {Pnd, Cfm, Disa, Intm, Always, FrfObd}, default-value=Pnd  # Describes when the record answers depending on the DTC state: in Fmy: Pnd or Cfm or Disa or Intm - or Always: (data always sent even though DTC is not stored in fmy), FrfObd: the data are sent only if the DTC is represents the FrfObd
            multiline string Description [0..20]  # If filled, this description will be shown on the generated DEM documentation
            boolean IsPartOfFFh: default-value=true  # If active, record is part of the overall record FFh
            boolean IsPartOfFEh: default-value=true  # If active, record is part of the overall record FEh
            string EnaInVariants [1..8]: default-value=*  # A list of variant names, e.g. 'US', 'EU', in which these feature shall be enabled. A '*' means for all variants.
            integer IdxFrfClass [0..1]: 0..65534, default-value=0  # In case of the IdxFrfClass is not empty: the record sends "OK", in case the frf class of the DTC matches the number mentioned at parameter IdxFrfClass the record sends "wrong record number", in case the frf class of the DTC does not match the mentioned given at parameter IdxFrfClass In case the IdxFrfClass is empty: the record sends "OK", even though the frf class index of the DTC does not match the mentioned given at parameter IdxFrfClass
            choice container Datas [1..*]
              container PassRecNbrFromDCM [1..*]  # If used, record number from DCM will be send (or in other words: passed through)
                integer Position: 0..65535, default-value=0  # Position of data in record buffer.
                multiline string Description [0..20]
              container FreezeFrameBlock [0..*]
                integer Position: 0..65535, default-value=0  # Position of data in record buffer.
                multiline string Description [0..20]
                integer NrFrame: 0..254, default-value=0  # Frame number (set number) of freeze frame block (0-based indexing)
                boolean SendHighByteFirstOfData: default-value=true  # If active, high byte of freeze frame data is sent first - if not active, low byte of freeze frame data is sent first.
                enumeration OutputFormat: {Data, Size_Data, Did_Size_Data, Did_Data}, default-value=Data  # Describes which additional data has to send in addition per freeze frame data (Did and/or size) and in which order.
                enumeration DataLength: {DataLengthOrigin, Bytes2, Bytes4}, default-value=DataLengthOrigin  # Data length format possibilities: origin length like defined in ECU or with padding to 2 or 4 Byte.
                enumeration EmptyFrameConfig: {UseLastFrameStored, SendZeroFrame, SendZeroData, SendNoData, SendNoRecord}  # Content/behaviour of record, if requested freeze frame has not been stored yet
                boolean CalBlockPadding: default-value=false  # if active, calibrateable frames are filled with 0 until NrOfBytesPerFrame (see FreezeFrameBlock configuration of calibration block)
                choice reference NameFreezeFrameBlockRef: destination=FreezeFrameBlocks/FreezeFrameBlock  # Freeze Frame block
              container CtrOcc [0..*]  # Occurence counter
                integer Position: 0..65535, default-value=0  # Position of data in record buffer.
                multiline string Description [0..20]
                integer LimitValue: 0..255, default-value=0  # Limit value of occurence counter
              container CtrCycAgi [0..*]  # Aging cycle counter
                integer Position: 0..65535, default-value=0  # Position of data in record buffer.
                multiline string Description [0..20]
                enumeration CountingDirection: {CountUpwards, CountDownwardsStopAt0, CountDownwardsStopAt1}, default-value=CountUpwards  # CtrCycAgi displayed in incrementing or decrementing fromat (in case of decrementing options to stop at 0 or 1 available)
                integer LimitValue: 0..255, default-value=0  # Limit value of CtrCycAgi (has only an impact, if CtrCycAgi is incrementing)
              container Constant [0..*]  # Constant value
                integer Position: 0..65535, default-value=0  # Position of data in record buffer.
                multiline string Description [0..20]
                integer Value: 0..255, default-value=0  # Value of the constant
                boolean IsDid: default-value=false  # If active, constant is considered as a DID
              container CalibrationClass [0..*]  # Content of calibration class element
                integer Position: 0..65535, default-value=0  # Position of data in record buffer.
                multiline string Description [0..20]
              container GetStatusOfDtc [0..*]  # Status of DTC
                integer Position: 0..65535, default-value=0  # Position of data in record buffer.
                multiline string Description [0..20]
              container Pid [0..*]  # PID format configuration
                integer Position: 0..65535, default-value=0  # Position of data in record buffer.
                multiline string Description [0..20]
                integer NrPid: 0..255, default-value=0  # PID number
                integer PidPosition: 0..7, default-value=0  # PID Index (refer to DemPidDataElement - index)
                boolean SendHighByteFirstOfData: default-value=true  # If active, high byte of freeze frame data is sent first - if not active, low byte of freeze frame data is sent first.
                enumeration OutputFormat: {Data, Size_Data, Pid_Size_Data, Pid_Data}, default-value=Data  # Describes which additional data has to send in addition to the PID data (Pid number and/or size) and in which order.
                enumeration DataLength: {UseDataLengthFromEcu, Bytes2, Bytes4}, default-value=UseDataLengthFromEcu  # Data length format possibilities: origin length like defined in ECU or with padding to 2 or 4 Byte.
              container IumprDen [0..*]
                integer Position: 0..65535, default-value=0  # Position of data in record buffer.
                multiline string Description [0..20]
                boolean SendHighByteFirstOfData: default-value=true  # If active, high byte of denominator is sent first - if not active, low byte of denominator is sent first.
                boolean SendZeroForNonIumpr: default-value=true  # If active, send 0 in case of DTC is not configured for IUMPR; else: send nothing -- response OK with 0 byte buffer
              container IumprNum [0..*]
                integer Position: 0..65535, default-value=0  # Position of data in record buffer.
                multiline string Description [0..20]
                boolean SendHighByteFirstOfData: default-value=true  # If active, high byte of numerator is sent first - if not active, low byte of numerator is sent first.
                boolean SendZeroForNonIumpr: default-value=true  # If active, send 0 in case of DTC is not configured for IUMPR; else: send nothing -- response OK with 0 byte buffer
              container StandardData [0..*]  # Not active/supported by DEM
                integer Position: 0..65535, default-value=0  # Position of data in record buffer.
                multiline string Description [0..20]
                multiline string StandardText [1..20]
              container Fdc [0..*]  # Fault detection counter
                integer Position: 0..65535, default-value=0  # Position of data in record buffer.
                multiline string Description [0..20]
              container LiveData [0..*]  # Not active/supported by DEM
                integer Position: 0..65535, default-value=0  # Position of data in record buffer.
                multiline string Description [0..20]
                multiline string DataShortNameRef  # ShortName of any /AUTOSAR_Dem/EcuModuleDefs/Dem/DemGeneral/DemDataElementClass/*
                boolean SendDid: default-value=false  # If active, the DID is sent before the data.
              container CtrCycCfm [0..*]
                integer Position: 0..65535, default-value=0  # Position of data in record buffer.
                multiline string Description [0..20]
              container CtrCycHeal [0..*]
                integer Position: 0..65535, default-value=0  # Position of data in record buffer.
                multiline string Description [0..20]
              container CtrCus [0..*]
                integer Position: 0..65535, default-value=0  # Position of data in record buffer.
                multiline string Description [0..20]
                choice reference CtrCusRef: destination=FmyCtrCus/CtrCus  # Customer counter to report
              container CtrHisStor [0..*]
                integer Position: 0..65535, default-value=0  # Position of data in record buffer.
                multiline string Description [0..20]
              container CtrFmyB1 [0..*]
                integer Position: 0..65535, default-value=0  # Position of data in record buffer.
                multiline string Description [0..20]
              container OvfFmy [0..*]
                integer Position: 0..65535, default-value=0  # Position of data in record buffer.
                multiline string Description [0..20]
                enumeration Origin: {PRIMARY, SECONDARY}  # Selects the memory origin for which to repor the overflow
              container NumberOfIdentifiers  # If used, number of all DIDs from FreezeFrameBlocks and from type constant (which are marked as DID) are sent (number is computed internally by DEM)
                integer Position: 0..65535, default-value=0  # Position of data in record buffer.
                multiline string Description [0..20]  # Computed amount of all configured DIDs
              container FctSpc [0..*]  # Content of function added here is sent: function definition must respect following prototype: uint8 function(sint8 ArgIdxFmy, Icsp_Dem_EventIdType ArgEventId, uint8 *ArgPtrNrOfDids, uint16 *ArgPtrBufSize, uint8 *ArgPtrDestBuffer)
                integer Position: 0..65535, default-value=0  # Position of data in record buffer.
                multiline string FunctionName  # Name of project specific hook function
                multiline string Description [0..20]
              container IdxFrfClass [0..*]
                integer Position: 0..65535, default-value=0  # Position of data in record buffer.
                multiline string Description [0..20]  # Freeze frame class index per EventId
              container IdxClass [0..*]  # Failure class of the Event
                integer Position: 0..65535, default-value=0  # Position of data in record buffer.
                multiline string Description [0..20]
              container RecordDtc [0..*]  # DTC of the Event
                integer Position: 0..65535, default-value=0  # Position of data in record buffer.
                multiline string Description [0..20]
                enumeration Format: {OBD_2_BYTE, OBD_3_BYTE}
      container FreezeFrameBlocks
        boolean DisplayDataNameInFrfBuf [0..1]: default-value=false  # If active, data name is visible at Icsp_Dem_Frf_FrfBuf[][] e.g. Icsp_Dem_Frf_FrfBuf[0][OBD_fac_mff_mpl_inj_hom_mpi_sae_0]
        boolean UsePidForCalibration: default-value=false  # Add PID_xx to the conversion symbol to select freeze-frame data
        boolean UseDidForCalibration: default-value=false  # Add DID_xxxx to the conversion symbol to select freeze-frame data
        boolean UseAllDataForCalibration: default-value=false  # If active, all configured data of all available freeze frame blocks can be selected in calibration
        enumeration DID_PID_SN_Sequence: {DID_PID_SN, DID_SN_PID, PID_DID_SN, PID_SN_DID, SN_DID_PID, SN_PID_DID, DID_PID_SN_SZ, DID_SN_PID_SZ, PID_DID_SN_SZ, PID_SN_DID_SZ, SN_DID_PID_SZ, SN_PID_DID_SZ}, default-value=DID_PID_SN  # Type of service (available configuration: 19 06h and 19 04h)
        container FreezeFrameBlock [0..*]
          integer NrTot: 0..255, default-value=0  # Total number of frames (NrTot - NrHold = number of frames which are updated frequently)
          integer NrHold: 0..255, default-value=0  # Number of frames kept after written the first time
          boolean ObdRelevant: default-value=false  # If active, block is considered as OBD block - needed for PID selection in services and mode 2h
          enumeration Update [1..*]: {EveryOccurence, FirstFail, FirstFailThisCycle, CfmWithoutPndCycMax, FailAfterDisappeared, EveryIntm, FirstIntm, EveryIntmAfterFail, CfmReached}  # Point of time when writeable frame has to be written
          enumeration Restart [0..*]: {EveryOccurence, FirstFail, FirstFailThisCycle, CfmWithoutPndCycMax, FailAfterDisappeared, EveryIntm, FirstIntm, EveryIntmAfterFail, CfmReached}  # Point of time when all frames (including the NrHold frames) has to be written from scratch
          choice container FreezeFrameCalibration [0..1]
            container EventId [0..1]  # If configured, for each EventId one freeze frame calibration exists
              integer NrOfCalibrationSlots: 0..255, default-value=0  # Number of calibration slots per EventId
              integer NrOfBytesPerFrame: 0..65535, default-value=0  # Number of bytes available per EventId calibration
            container FrfClass [0..1]  # If configured, for each freeze frame class a calibration exists
              integer NrOfCalibrationSlots: 0..255, default-value=0  # Number of calibration slots per freeze frame class
              integer NrOfBytesPerFrame: 0..65535, default-value=0  # Number of bytes available per freeze frame class calibration
              multiline string NameOfFrfClasses [1..65535]: requires-index=true  # Class name
            container Common [0..1]
              integer NrOfCalibrationSlots: 0..255, default-value=0  # Number of calibration slots per common calibration
              integer NrOfBytesPerFrame: 0..65535, default-value=0  # Number of bytes available per common calibration
    container His
      integer NrHis [0..1]: 0..255, default-value=10  # Number of history memory failure entries. Configuring 0 removes this feature completely.
      boolean StoreStatusOfDtc: default-value=true  # Status of Dtc is stored at the time of the entrance in History memory
      boolean OverwriteWhenFull: default-value=false  # History memory strategy : When history memory is full and OverwriteWhenFull selected, oldest failure is replaced by the new one
      boolean CountTimesEntered [0..1]: default-value=false  # Counts number of times entered
      enumeration StorageCondition [0..1]: {AGI, CLR, ALWAYS}, default-value=ALWAYS  # Condition to store from Fmy to His
    container Iumpr
      boolean Enabled: default-value=true  # Enables the in-use monitoring performance ratio feature
      integer NumberOfCalibratableRatios: 0..255, default-value=3  # Number of in-use monitoring performance ratios with calibratable reference to Event and Fids
      integer NrFidMinIumpr: 0..255, default-value=0  # This parameter can be used to ensure a minimum number of FIDs per ratio. Only useful for calibratable ratios (NumberOfCalibratableRatios > 0).
      integer NrIumprGrpPrivate: 0..5, default-value=0  # Number of private groups activated (maximum is 5)
      enumeration LfDenCdnAssignment [0..1]: {CENTRAL, USER}, default-value=CENTRAL  # Moves the LfDenCdn calibration to Icsp_Dem_Iumpr (CENTRAL) or the related diagnostics (USER).
      enumeration GrpIumprAssignment [0..1]: {CENTRAL, USER}, default-value=USER  # Moves the Iumpr Group calibration to Icsp_Dem_Iumpr (CENTRAL) or the related diagnostics (USER).
      enumeration LfDenCdnDefinition [0..1]: {GEN, GEN_COLDSTART, GEN_EVAP, GEN_COLDSTART_EVAP, GEN_500MLS, GEN_COLDSTART_500MLS, GEN_EVAP_500MLS, GEN_COLDSTART_EVAP_500MLS}, default-value=OBDCond  # Select which calibration pattern shall be available for Ratio Denominator increment conditions conversion. No selection : calibration done through decimal value.
      string NameAir [0..1]: default-value=AIR  # Change the symbolic name of the group "Secondary air"
      string NameBp [0..1]: default-value=BP  # Change the symbolic name of the group "Boost pressure"
      string NameCat1 [0..1]: default-value=CAT1  # Change the symbolic name of the group "Catalyst 1"
      string NameCat2 [0..1]: default-value=CAT2  # Change the symbolic name of the group "Catalyst 2"
      string NameEgr [0..1]: default-value=EGR  # Change the symbolic name of the group "Exhaust gas recirciulation"
      string NameEgs [0..1]: default-value=EGS  # Change the symbolic name of the group "Exhaust gas sensor"
      string NameEvap [0..1]: default-value=EVAP  # Change the symbolic name of the group "Evaporative system"
      string NameFuel [0..1]: default-value=FUEL  # Change the symbolic name of the group "Fuel system"
      string NameHccat [0..1]: default-value=HCCAT  # Change the symbolic name of the group "NMHC Catalyst"
      string NameNads [0..1]: default-value=NADS  # Change the symbolic name of the group "NOx adsorber"
      string NameNcat [0..1]: default-value=NCAT  # Change the symbolic name of the group "NOx catalyst"
      string NameO2s1 [0..1]: default-value=O2S1  # Change the symbolic name of the group "Oxygen sensor 1"
      string NameO2s2 [0..1]: default-value=O2S2  # Change the symbolic name of the group "Oxygen sensor 2"
      string NamePm [0..1]: default-value=PM  # Change the symbolic name of the group "Particulate matter filter"
      string NameSo2s1 [0..1]: default-value=SO2S1  # Change the symbolic name of the group "Secondary oxygen sensor 1"
      string NameSo2s2 [0..1]: default-value=SO2S2  # Change the symbolic name of the group "Secondary oxygen sensor 2"
      string NameVvt [0..1]: default-value=VVT  # Change the symbolic name of the group "Variable Valve Timing"
      string NameAfri1 [0..1]: default-value=AFRI1  # Change the symbolic name of the group "Air-fuel ratio imbalance 1"
      string NameAfri2 [0..1]: default-value=AFRI2  # Change the symbolic name of the group "Air-fuel ratio imbalance 2"
      string NamePf1 [0..1]: default-value=PF1  # Change the symbolic name of the group "Particulate filter 1"
      string NamePf2 [0..1]: default-value=PF2  # Change the symbolic name of the group "Particulate filter 2"
      string NamePrivate{0..4} [0..1]: default-value=PRIVATE{0..4}  # Change the symbolic name of the group "Private (computed, but not reported in OBD services)"
      string NameNone [0..1]: default-value=NONE  # Change the symbolic name of the group "Not computed"
      boolean LvEgrVvtSplit [0..1]: default-value=false  # Splits the computation of EGR into EGR and VVT (default: off)
      boolean LvAfriPfEna [0..1]: default-value=false  # Enables the air-fuel ratio imbalance 1/2 and particulate filter 1/2 groups for gasoline (default: off)
      string FidDen_GENERAL_DENOMINATOR [0..1]
      string FidDen_DEN_COND_COLDSTART [0..1]
      string FidDen_DEN_COND_EVAP [0..1]
      string FidDen_DEN_COND_500MI [0..1]
      string FidDen_GENERAL_INDIVIDUAL_DENOMINATOR [0..1]
      string FidDen_GENERAL_OBDCOND [0..1]
    container Lamp
      integer NrIndicatorClass [0..1]: 1..16  # Number of lamps handled through the failure-class (default = all). Additional lamps are only accessible through Messages.
      container Messages [0..1]
        container MessageGroup [1..8]
          container Message [1..255]
            enumeration DemIndicatorBehaviour: {DEM_INDICATOR_ON_DEMAND, DEM_INDICATOR_SHORT, DEM_INDICATOR_CONTINUOUS, DEM_INDICATOR_SLOW_FLASH, DEM_INDICATOR_FAST_FLASH, DEM_INDICATOR_SPC_1, DEM_INDICATOR_SPC_2, DEM_INDICATOR_SPC_3, DEM_INDICATOR_SPC_4, DEM_INDICATOR_SPC_5, DEM_INDICATOR_SPC_6, DEM_INDICATOR_SPC_7, DEM_INDICATOR_SPC_8, DEM_INDICATOR_SPC_9, DEM_INDICATOR_SPC_10, DEM_INDICATOR_SPC_11, DEM_INDICATOR_SPC_12, DEM_INDICATOR_SPC_13, DEM_INDICATOR_SPC_14, DEM_INDICATOR_SPC_15, DEM_INDICATOR_SPC_16, DEM_INDICATOR_SPC_17, DEM_INDICATOR_SPC_18, DEM_INDICATOR_SPC_19, DEM_INDICATOR_SPC_20, DEM_INDICATOR_SPC_21, DEM_INDICATOR_SPC_22, DEM_INDICATOR_SPC_23, DEM_INDICATOR_SPC_24, DEM_INDICATOR_SPC_25, DEM_INDICATOR_SPC_26, DEM_INDICATOR_SPC_27, DEM_INDICATOR_SPC_28, DEM_INDICATOR_SPC_29, DEM_INDICATOR_SPC_30, DEM_INDICATOR_SPC_31}  # Behaviour of the linked indicator
            symbolic name reference IndicatorRef: destination=Indicator
      container Indicators
        container Indicator [1..255]
          integer Index
          string DemIndicatorNameRef
    container NvmSpc
      string Elements [0..65535]: requires-index=true  # List of data to be stored by Dem, block reset after ClrFmy
      string Elements_Rpg [0..65535]: requires-index=true  # List of data to be stored by Dem, block reset only after reprogramming
    container Perm
      integer NumberOfEntries [0..1]: 0..64, default-value=4  # Number of permanent entries. Configuring 0 removes this feature completely.
      boolean StPermVariant  # Permanent activation state can be calibrated independently for each variant (e.g., US vs. EU)
    container PidSpc
      boolean Enabled: default-value=true  # Enables the storage of PIDs 21, 30, 31, 4D, and 4E in Dem
    container Prio
      enumeration FindStrategy: default-value=OVERWRITE_NEWEST  # Defines whether to overwrite the oldest or newest failure.
        OVERWRITE_OLDEST  # Event memory entry displacement is disabled.
        OVERWRITE_NEWEST  # Event memory entry displacement is enabled, by consideration of priority and occurrence (but without active/passive status).
      boolean ProtectSngMilFault: default-value=true  # Protects a single entry which is turning on the MIL (lamp 0).
      integer PrioFailed [8..8]: 0..254, requires-index=true  # Mapping of calibrated priorities for failed entries.
      integer PrioHealed [8..8]: 0..254, requires-index=true  # Mapping of calibrated priorities for healed entries.
      integer PrioIntermittent [8..8]: 0..254, requires-index=true  # Mapping of calibrated priorities for intermittent entries.
      integer PrioPndDisaAging [8..8]: 0..254, requires-index=true  # Mapping of calibrated priorities for Pnd Disappeared Aging entries.
      enumeration EventDisplacementStrategy [0..1]: default-value=DEM_DISPLACEMENT_FULL  # Defines whether support for event displacement is enabled or not, and which displacement strategy is followed.
        DEM_DISPLACEMENT_NONE  # Event memory entry displacement is disabled.
        DEM_DISPLACEMENT_PRIO_OCC  # Event memory entry displacement is enabled, by consideration of priority and occurrence (but without active/passive status).
        DEM_DISPLACEMENT_FULL  # Event memory entry displacement is enabled, by consideration of priority active/passive status, and occurrence.
      boolean OBDEventDisplacement [0..1]: default-value=false  # Protect all emission related events with the following conditions: Event old triggers MIL indicator OR Event old is Pending AND event old has higher or equal OBD priority than new event.
      boolean IntmDisplacesPassedIntm [0..1]: default-value=false  # Consider PASS criteria (Event has passed since it became interminttent) for intermittent vs other intermittent displacement. If enabled, PASS criteria has higher importance that PrioIntermittent criteria.
    container Rdy
      boolean Enabled  # Enables the computation of the readiness (PID 01h) and completion (PID 41h) status. If disabled, calibration data is reported without computation.
      boolean CentralCalibrationVariant  # Switches the supported/forced-complete calibration switches to be variant specific.
      enumeration GrpRdy: {ROM_INVISIBLE, CAL_READONLY_CENTRAL, CAL_READONLY_USER, CAL_TUNABLE_CENTRAL, CAL_TUNABLE_USER}, default-value=CAL_TUNABLE_CENTRAL  # Selects how to integrate the calibration of the readiness group per Event.
      string NameAir [0..1]: default-value=AIR  # Change the symbolic name of the group "Secondary Air"
      string NameBp [0..1]: default-value=BP  # Change the symbolic name of the group "Boost Pressure"
      string NameCat [0..1]: default-value=CAT  # Change the symbolic name of the group "Catalyst"
      string NameCcm [0..1]: default-value=CCM  # Change the symbolic name of the group "Comprehensive Component"
      string NameEgr [0..1]: default-value=EGR  # Change the symbolic name of the group "Exhaust Gas Recirculation"
      string NameEgs [0..1]: default-value=EGS  # Change the symbolic name of the group "Exhaust Gas Sensor"
      string NameEvap [0..1]: default-value=EVAP  # Change the symbolic name of the group "Evaporative System"
      string NameFuelCont [0..1]: default-value=FUEL_CONT  # Change the symbolic name of the group "Fuel (continuous diagnostics)"
      string NameFuelNoncont [0..1]: default-value=FUEL_NONCONT  # Change the symbolic name of the group "Fuel (non-continuous diagnostics)"
      string NameHcat [0..1]: default-value=HCAT  # Change the symbolic name of the group "Heated Catalyst"
      string NameHccat [0..1]: default-value=HCCAT  # Change the symbolic name of the group "NMHC Catalyst"
      string NameHtr [0..1]: default-value=HTR  # Change the symbolic name of the group "Catalyst Heater"
      string NameMis [0..1]: default-value=MIS  # Change the symbolic name of the group "Misfire"
      string NameNcat [0..1]: default-value=NCAT  # Change the symbolic name of the group "NOx Catalyst"
      string NameO2s [0..1]: default-value=O2S  # Change the symbolic name of the group "Oxygen Sensor"
      string NamePm [0..1]: default-value=PM  # Change the symbolic name of the group "Particulate Matter Filter"
      string NamePrivate [0..1]: default-value=PRIVATE  # Change the symbolic name of the group "Private (not reported)"
      string NameNone [0..1]: default-value=NONE  # Change the symbolic name of the group "None (not computed)"
      string Pid01ByteAZeroInVariants [0..8]  # A list of variant names, e.g. 'US', 'EU', in which byte A for Pid01 shall be forced to zero. Typically needed for WWH. A '*' means for all variants. An empty list means never.
      enumeration GrpRdyNotRelevant [0..*]: {DEM_OBD_RDY_AC, DEM_OBD_RDY_BOOSTPR, DEM_OBD_RDY_CAT, DEM_OBD_RDY_CMPRCMPT, DEM_OBD_RDY_EGSENS, DEM_OBD_RDY_ERG, DEM_OBD_RDY_EVAP, DEM_OBD_RDY_FLSYS, DEM_OBD_RDY_HCCAT, DEM_OBD_RDY_HTCAT, DEM_OBD_RDY_MISF, DEM_OBD_RDY_NONE, DEM_OBD_RDY_NOXCAT, DEM_OBD_RDY_O2SENS, DEM_OBD_RDY_O2SENSHT, DEM_OBD_RDY_PMFLT, DEM_OBD_RDY_SECAIR, DEM_OBD_RDY_FLSYS_NONCONT, DEM_OBD_RDY_PRIVATE, UNKNOWN}  # This parameter specifies the Event OBD Readiness group for PID $01 and PID $41 computation. | This parameter is only applicable for emission-related ECUs.
    container Scdn
      boolean Enabled: default-value=true  # Enables the the Similar Driving Condition feature
      boolean ScdnEnaVariant  # Activation/deactivation of Similar Driving Conditions functionnality can be calibrated independently for each variant (e.g., US vs. EU)
      container Conditions [0..1]
        container Condition [0..127]
          enumeration ConditionType: {RANGE, THRESHOLD}  # Select condition type : RANGE or THRESHOLD
          string Description [0..1]  # Decription of the condition to be used
          choice container DataElement
            container Pid [0..1]
              integer Pid: 0..255  # PID number to be used for this condition
              integer PidDataPos: 0..255  # PID index (in case of multiple elements exists)
