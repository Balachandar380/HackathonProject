AUTOSAR XML (schema 4-0-3)
package /Continental_08/PowerSAR/ICSP/EcuModuleDefs
  module config DemGenr
    General:
      EngineType = GASOLINE
      TypEngVariant = false
      WarnAboutMissingCalibration = false
      Variants = US
      Variants = EU
      Variants = NoObd
      WWH_OBD = DISABLED
      CallbackClearConditionFcn = ACTION_ERRM_GetCdnClrFmy
      NvmWrRunAllEna = false
    Bench: NrBench=10
    Class:
      NumberOfClasses = 30
      StLvlDiagVariant = false
      StPrioDiagSrvVariant = false
      StAgiStgyVariant = false
      CtrAgiThdVariant = false
      StLampVariant = false
      CtrCycCfmVariant = true
      StLvlDiagEnabled = false
      StLvlDiagWithObdClass = false
      CtrCycHealVariant = false
      IdxClassIntm = DISABLED
      IdxClass = USER
      StPrioIntmDiagSrv = NORMAL
      StSrvSec = DISABLED
      IdxClassVariant = false
      CalibrationClasses
        Icsp_Dem_Class_StSpcCus (CalibrationClass)
          FEHLER (Element): Index=2, Name=FEHLER
          HINWEIS (Element): Index=6, Name=HINWEIS
    DcmIf: StObdReqVariant=true, AuxIdControlDtcSetting=SRV_85_0, StatusOfDtcFailedSinceLastClear=LvErrClr
    Deb: AllEventsDisabledByDefault=false, LfIniTyp=USER, LfIniTypVariant=false
      Mapping:
        DemDebounceUnknown = DemDebounceLegacyS16
        DemDebounceCounterBased = DemDebounceLegacyS16
        DemDebounceTimeBase = DemDebounceLegacyS16
        DemDebounceLegacyMpl = DemDebounceLegacyS16
        DemDebounceLegacyCalClas = DemDebounceLegacyS16
        DemDebounceLegacyConfClas = DemDebounceLegacyS16
        DemDebounceLegacyStc = DemDebounceLegacyS16
      EnableConditions
        4 x EnableCondition, all with EnableConditionStatusInitial=true, ControlDtcSetting=false, DisablesPid0x41=false:
          OBD_BAT_NOT_VLD: Index=2, DemEnableConditionNameRef=EnableCondition_OBD_BAT_NOT_VLD
          OBD_ES_KEY_ON: Index=10, DemEnableConditionNameRef=EnableCondition_OBD_ES_KEY_ON
          OBD_PWL: Index=3, DemEnableConditionNameRef=EnableCondition_OBD_PWL
          OBD_WKU: Index=7, DemEnableConditionNameRef=EnableCondition_OBD_WKU
    DebCtr: AbcDecFixed=false, AbcIncFixed=false, AbcMaxFixed=false, AbcMinFixed=false, JumpDownFixed=false, JumpUpFixed=false
    Dtc:
      ObdDtc = Icsp_Dem_Dtc_DtcObd
      UdsDtc16bitPart = Icsp_Dem_Dtc_DtcCus
      UdsDtc16bitIsLowPart = true
      DtcDisplayFmy = UDS
      UdsDtcTranslationType = DEM_DTC_TRANSLATION_ISO14229_1
      DtcAssignment = CENTRAL
      UdsDtcTranslationTypeEmi = DEM_DTC_TRANSLATION_SAEJ2012_DA_04
      DtcGroups
        OBD (DtcGroup):
          DtcKind = OBD
          DtcRangeMin = 0
          DtcRangeMax = 16777215
          ExecuteSysTranClrFmy = true
          SelectedEvents = ALL
          EnaInVariants = *
          LvClrDwis = false
          LvClrHis = false
          LvClrPerm = false
          LvNvmWrOnClr = false
        UDS_ALL (DtcGroup):
          DtcKind = UDS
          DtcRangeMax = 16777215
          DtcRangeMin = 16777215
          EnaInVariants = *
          ExecuteSysTranClrFmy = true
          SelectedEvents = ALL
          LvClrDwis = false
          LvClrHis = false
          LvClrPerm = false
          LvNvmWrOnClr = false
    Dtr: Enabled=true, UseAlternativeUnits=false, TidAssignment=CAL_TUNABLE_CENTRAL, DtrMidsCalibratable=false, NumberOfSparesPerUsedMid=0
    Dwis: NrEveDwis=0
    Fmy: NrFmy=20, MilGrouping=CAL_TUNABLE_CENTRAL, IntmEna=true
    FmyCtrCus
    Frf: CalibrationAssignment=USER
      FreezeFrameServices
        SERVICE_19_06h (FreezeFrameService): ServiceType=SERVICE_19_06h, UseUdsObdRange=false, DefaultFFh=false, SortRecordsByShortName=false
          4 x Record, all with ObdRelevant=false, IsPartOfFEh=false, IsPartOfFFh=true, EnaInVariants=*, OutputRlv=Pnd, OutputRlv=Cfm, OutputRlv=Disa:
            Record_01h: RecordNumber=1, FctToOverWriteBuf=
              3 x Datas:
                RecordNumber01h
                  RecordNumber01h (Constant): Position=0, Value=1, OutputRlv=InFmy, IsDid=false
                FailurePriority
                  Icsp_Dem_Class_StSpcCus (CalibrationClass): Position=1, OutputRlv=InFmy
                OccurenceCounter
                  CtrOcc: Position=2, LimitValue=255, OutputRlv=InFmy
            Record_02h: RecordNumber=2, FctToOverWriteBuf=
              5 x Datas:
                RecordNumber02h
                  RecordNumber02h (Constant): Position=3, Value=2, OutputRlv=InFmy, IsDid=false
                WarmUpCounter
                  CtrCycAgi: Position=4, LimitValue=0, CountingDirection=CountDownwardsStopAt1
                Km_Mileage
                  CMN1_Block (FreezeFrameBlock):
                    Position = 5
                    NrFrame = 0
                    SendHighByteFirstOfData = true
                    OutputFormat = Data
                    DataLength = DataLengthOrigin
                    EmptyFrameConfig = UseLastFrameStored
                    CalBlockPadding = false
                    OutputRlv = InFmy
                    NameFreezeFrameBlockRef = CMN1
                TimeIndicationBit
                  Constant: Position=6, Value=0, OutputRlv=InFmy, IsDid=false
                TimeStamp
                  CMN2_Block (FreezeFrameBlock):
                    Position = 7
                    NrFrame = 0
                    SendHighByteFirstOfData = true
                    OutputFormat = Data
                    DataLength = DataLengthOrigin
                    EmptyFrameConfig = UseLastFrameStored
                    CalBlockPadding = false
                    OutputRlv = InFmy
                    NameFreezeFrameBlockRef = CMN2
            Record_70h: RecordNumber=112, FctToOverWriteBuf=Icsp_Dem_Frf_OverWriteFrfBuf
              8 x Datas:
                RecordNumber70h
                  RecordNumber70h (Constant): Position=8, Value=112, OutputRlv=InFmy, IsDid=false
                PID_0Ch
                  PID_0Ch_0 (Pid): Position=9, NrPid=12, SendHighByteFirstOfData=true, OutputFormat=Data, DataLength=UseDataLengthFromEcu, PidPosition=0, OutputRlv=InFmy
                PID_04h
                  PID_04h_0 (Pid): Position=10, NrPid=4, SendHighByteFirstOfData=true, OutputFormat=Data, DataLength=UseDataLengthFromEcu, PidPosition=0, OutputRlv=InFmy
                PID_0Dh
                  PID_0Dh_0 (Pid): Position=11, NrPid=13, SendHighByteFirstOfData=true, OutputFormat=Data, DataLength=UseDataLengthFromEcu, PidPosition=0, OutputRlv=InFmy
                PID_05h
                  PID_05h_0 (Pid): Position=12, NrPid=5, SendHighByteFirstOfData=true, OutputFormat=Data, DataLength=UseDataLengthFromEcu, PidPosition=0, OutputRlv=InFmy
                PID_0Fh
                  PID_0Fh_0 (Pid): Position=13, NrPid=15, SendHighByteFirstOfData=true, OutputFormat=Data, DataLength=UseDataLengthFromEcu, PidPosition=0, OutputRlv=InFmy
                PID_33h
                  PID_33h_0 (Pid): Position=14, NrPid=51, SendHighByteFirstOfData=true, OutputFormat=Data, DataLength=UseDataLengthFromEcu, PidPosition=0, OutputRlv=InFmy
                PID_42h
                  PID_42h_0 (Pid): Position=15, NrPid=66, SendHighByteFirstOfData=true, OutputFormat=Data, DataLength=UseDataLengthFromEcu, PidPosition=0, OutputRlv=InFmy
            Record_71h: RecordNumber=113, FctToOverWriteBuf=Icsp_Dem_Frf_OverWriteFrfBuf
              5 x Datas:
                RecordNumber71h
                  RecordNumber71h (Constant): Position=16, Value=113, OutputRlv=InFmy, IsDid=false
                IDservice22_high_byte
                  Constant: Position=17, Value=32, OutputRlv=InFmy, IsDid=true
                IDservice22_low_byte
                  Constant: Position=18, Value=150, OutputRlv=InFmy, IsDid=false
                WarmUpCounter
                  CtrCycAgi: Position=19, CountingDirection=CountDownwardsStopAt1, LimitValue=0, OutputRlv=InFmy
                Block_SPC
                  FreezeFrameBlock:
                    Position = 20
                    NrFrame = 0
                    SendHighByteFirstOfData = true
                    OutputFormat = Did_Data
                    DataLength = DataLengthOrigin
                    EmptyFrameConfig = UseLastFrameStored
                    CalBlockPadding = false
                    OutputRlv = InFmy
                    NameFreezeFrameBlockRef = SPC
        SERVICE_19_04h (FreezeFrameService): ServiceType=SERVICE_19_04h, UseUdsObdRange=false, DefaultFFh=false, SortRecordsByShortName=false
      FreezeFrameBlocks:
        UseAllDataForCalibration = false
        UseDidForCalibration = true
        UsePidForCalibration = false
        DID_PID_SN_Sequence = SN_DID_PID_SZ
        DisplayDataNameInFrfBuf = true
        4 x FreezeFrameBlock, all with NrTot=1, NrHold=1, Update=FirstFail, Restart=FirstFail:
          OBD: ObdRelevant=true, Restart=FailAfterDisappeared
          CMN1: ObdRelevant=false
          CMN2: ObdRelevant=false
          SPC: ObdRelevant=false, Restart=FailAfterDisappeared
            FreezeFrameCalibration
              Icsp_Dem_Frf_IdxData_Class (FrfClass):
                NrOfCalibrationSlots = 7
                NrOfBytesPerFrame = 14
                NameOfFrfClasses = CLASS_{001..150}
    His: NrHis=0, OverwriteWhenFull=true, StorageCondition=ALWAYS, StoreStatusOfDtc=true, CountTimesEntered=false, ClearHisAtClearFmy=false
    Iumpr:
      NrFidMinIumpr = 2
      Enabled = true
      NumberOfCalibratableRatios = 10
      NrIumprGrpPrivate = 1
      EventAndFidRelationA2lVisible = false
      NamePrivate0 = PRIVATE
      NameVvt = -
      LvAfriPfEna = true
      LvEgrVvtSplit = false
      LfDenCdnDefinition = GEN_COLDSTART_EVAP
      FidDen_DEN_COND_COLDSTART = RBM_CST_OBD
      FidDen_DEN_COND_EVAP = RBM_EVAP_OBD
      FidDen_GENERAL_INDIVIDUAL_DENOMINATOR = RBM_GEN_DEN
      FidDen_GENERAL_OBDCOND = RBM_GEN_DEN_OBD
    Lamp: NrIndicatorClass=2
      Indicators
        MIL (Indicator): DemIndicatorNameRef=DEM_MIL_ID, Index=0
        WAL (Indicator): DemIndicatorNameRef=DEM_WAL_ID, Index=1
    Perm: NumberOfEntries=4, StPermVariant=true
    Prio:
      ProtectSngMilFault = true
      FindStrategy = OVERWRITE_NEWEST
      PrioFailed = 18
      PrioFailed = 20
      PrioFailed = 22
      PrioFailed = 24
      PrioFailed = 26
      PrioFailed = 28
      PrioFailed = 30
      PrioFailed = 32
      PrioHealed = 17
      PrioHealed = 19
      PrioHealed = 21
      PrioHealed = 23
      PrioHealed = 25
      PrioHealed = 27
      PrioHealed = 29
      PrioHealed = 31
      PrioIntermittent = {1..8}
      PrioPndDisaAging = {9..16}
      IntmDisplacesPassedIntm = false
      OBDEventDisplacement = false
      EventDisplacementStrategy = DEM_DISPLACEMENT_FULL
    Rdy: CentralCalibrationVariant=true, GrpRdy=CAL_TUNABLE_CENTRAL, Enabled=true, NameFuelCont=FUELcont, NameFuelNoncont=FUEL, Pid01ByteAEnaInVariants=*
    PidSpc: Enabled=true
    Scdn: Enabled=true, ScdnEnaVariant=true
      Conditions
        3 x Condition:
          LoadClcSae: ConditionType=RANGE, Description=Calculated load
            DataElement
              Pid_04h_Pos_0 (Pid): Pid=4, PidDataPos=0
          TcoSae: ConditionType=THRESHOLD, Description=Coolant temperature
            DataElement
              Pid_05h_Pos_0 (Pid): Pid=5, PidDataPos=0
          NSae: ConditionType=RANGE, Description=Engine speed
            DataElement
              Pid_0Ch_Pos_0 (Pid): Pid=12, PidDataPos=0
